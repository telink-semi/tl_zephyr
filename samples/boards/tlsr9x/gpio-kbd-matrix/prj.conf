## prj.conf
```kconfig
CONFIG_LOG=y
CONFIG_LOG_MODE_MINIMAL=y

CONFIG_INPUT_GPIO_KBD_MATRIX=y
CONFIG_INPUT=y
CONFIG_INPUT_KEYMAP=y
```

## boards/tl3218x.overlay
```dts
#include <zephyr/dt-bindings/input/input-event-codes.h>
#include <zephyr/dt-bindings/input/keymap.h>

/ {
	kbd: kbd-matrix {
		compatible = "gpio-kbd-matrix";
		row-gpios = <&gpiob 3 (GPIO_PULL_UP | GPIO_ACTIVE_LOW)>,
					<&gpiob 5 (GPIO_PULL_UP | GPIO_ACTIVE_LOW)>;
		col-gpios = <&gpiob 6 GPIO_ACTIVE_LOW>,
					<&gpiob 7 GPIO_ACTIVE_LOW>;
		idle-mode = "interrupt";
		kbd_keymap: kbd-matrix-map {
			compatible = "input-keymap";
			keymap = <MATRIX_KEY(0, 0, INPUT_KEY_1)
						MATRIX_KEY(0, 1, INPUT_KEY_2)
						MATRIX_KEY(1, 0, INPUT_KEY_3)
						MATRIX_KEY(1, 1, INPUT_KEY_4)>;
			row-size = <2>;
			col-size = <2>;
		};
	};

	/delete-node/ keys;
	/delete-node/ key_pool;
	/delete-node/ key_matrix;

	aliases {
		/delete-property/ sw0;
		/delete-property/ sw1;
		/delete-property/ sw2;
		/delete-property/ sw3;
		/delete-property/ mcuboot-button0;
	};
};
```

## boards/tl3228x.overlay
```dts
#include <zephyr/dt-bindings/input/input-event-codes.h>
#include <zephyr/dt-bindings/input/keymap.h>

/ {
	kbd: kbd-matrix {
		compatible = "gpio-kbd-matrix";
		row-gpios = <&gpiog 0 (GPIO_PULL_UP | GPIO_ACTIVE_LOW)>,
					<&gpiog 1 (GPIO_PULL_UP | GPIO_ACTIVE_LOW)>;
		col-gpios = <&gpiog 2 GPIO_ACTIVE_LOW>,
					<&gpiog 3 GPIO_ACTIVE_LOW>;
		idle-mode = "interrupt";
		kbd_keymap: kbd-matrix-map {
			compatible = "input-keymap";
			keymap = <MATRIX_KEY(0, 0, INPUT_KEY_7)
						MATRIX_KEY(0, 1, INPUT_KEY_6)
						MATRIX_KEY(1, 0, INPUT_KEY_4)
						MATRIX_KEY(1, 1, INPUT_KEY_3)>;
			row-size = <2>;
			col-size = <2>;
		};
	};

	/delete-node/ keys;
	/delete-node/ key_pool;
	/delete-node/ key_matrix;

	aliases {
		/delete-property/ sw0;
		/delete-property/ sw1;
		/delete-property/ sw2;
		/delete-property/ sw3;
		/delete-property/ mcuboot-button0;
	};
};
```

## boards/tl3238x.overlay
```dts
#include <zephyr/dt-bindings/input/input-event-codes.h>
#include <zephyr/dt-bindings/input/keymap.h>

/ {
	kbd: kbd-matrix {
		compatible = "gpio-kbd-matrix";
		row-gpios = <&gpioc 4 (GPIO_PULL_UP | GPIO_ACTIVE_LOW)>,
					<&gpioc 5 (GPIO_PULL_UP | GPIO_ACTIVE_LOW)>;
		col-gpios = <&gpioc 6 GPIO_ACTIVE_LOW>,
					<&gpioc 7 GPIO_ACTIVE_LOW>;
		idle-mode = "interrupt";
		kbd_keymap: kbd-matrix-map {
			compatible = "input-keymap";
			keymap = <MATRIX_KEY(0, 0, INPUT_KEY_1)
						MATRIX_KEY(0, 1, INPUT_KEY_2)
						MATRIX_KEY(1, 0, INPUT_KEY_4)
						MATRIX_KEY(1, 1, INPUT_KEY_3)>;
			row-size = <2>;
			col-size = <2>;
		};
	};

	/delete-node/ keys;
	/delete-node/ key_pool;
	/delete-node/ key_matrix;

	aliases {
		/delete-property/ sw0;
		/delete-property/ sw1;
		/delete-property/ sw2;
		/delete-property/ sw3;
		/delete-property/ mcuboot-button0;
	};
};
```

## boards/tl7218x.overlay
```dts
#include <zephyr/dt-bindings/input/input-event-codes.h>
#include <zephyr/dt-bindings/input/keymap.h>

/ {
	kbd: kbd-matrix {
		compatible = "gpio-kbd-matrix";
		row-gpios = <&gpiod 4 (GPIO_PULL_UP | GPIO_ACTIVE_LOW)>,
					<&gpiod 6 (GPIO_PULL_UP | GPIO_ACTIVE_LOW)>;
		col-gpios = <&gpiod 5 GPIO_ACTIVE_LOW>,
					<&gpiod 7 GPIO_ACTIVE_LOW>;
		idle-mode = "interrupt";
		kbd_keymap: kbd-matrix-map {
			compatible = "input-keymap";
			keymap = <MATRIX_KEY(0, 0, INPUT_KEY_1)
						MATRIX_KEY(0, 1, INPUT_KEY_2)
						MATRIX_KEY(1, 0, INPUT_KEY_3)
						MATRIX_KEY(1, 1, INPUT_KEY_4)>;
			row-size = <2>;
			col-size = <2>;
		};
	};

	/delete-node/ keys;
	/delete-node/ key_pool;
	/delete-node/ key_matrix;

	aliases {
		/delete-property/ sw0;
		/delete-property/ sw1;
		/delete-property/ sw2;
		/delete-property/ sw3;
		/delete-property/ mcuboot-button0;
	};
};
```

## boards/tlsr9118bdk40d_v1.overlay
```dts
#include <zephyr/dt-bindings/input/input-event-codes.h>
#include <zephyr/dt-bindings/input/keymap.h>

/ {
	kbd: kbd-matrix {
		compatible = "gpio-kbd-matrix";
		row-gpios = <&gpio0 16 (GPIO_PULL_UP | GPIO_ACTIVE_LOW)>,
					<&gpio0 15 (GPIO_PULL_UP | GPIO_ACTIVE_LOW)>;
		col-gpios = <&gpio0 18 GPIO_ACTIVE_LOW>,
					<&gpio0 17 GPIO_ACTIVE_LOW>;
		idle-mode = "interrupt";
		kbd_keymap: kbd-matrix-map {
			compatible = "input-keymap";
			keymap = <MATRIX_KEY(0, 0, INPUT_KEY_1)
						MATRIX_KEY(0, 1, INPUT_KEY_2)
						MATRIX_KEY(1, 0, INPUT_KEY_3)
						MATRIX_KEY(1, 1, INPUT_KEY_4)>;
			row-size = <2>;
			col-size = <2>;
		};
	};

	/delete-node/ keys;
	/delete-node/ key_pool;
	/delete-node/ key_matrix;

	aliases {
		/delete-property/ sw0;
		/delete-property/ sw1;
		/delete-property/ sw2;
		/delete-property/ sw3;
		/delete-property/ mcuboot-button0;
	};
};
```

## boards/tlsr9518adk80d.overlay
```dts
#include <zephyr/dt-bindings/input/input-event-codes.h>
#include <zephyr/dt-bindings/input/keymap.h>

/ {
	kbd: kbd-matrix {
		compatible = "gpio-kbd-matrix";
		row-gpios = <&gpioc 3 (GPIO_PULL_UP | GPIO_ACTIVE_LOW)>,
					<&gpioc 1 (GPIO_PULL_UP | GPIO_ACTIVE_LOW)>;
		col-gpios = <&gpioc 2 GPIO_ACTIVE_LOW>,
					<&gpioc 0 GPIO_ACTIVE_LOW>;
		idle-mode = "interrupt";
		kbd_keymap: kbd-matrix-map {
			compatible = "input-keymap";
			keymap = <MATRIX_KEY(0, 0, INPUT_KEY_1)
						MATRIX_KEY(0, 1, INPUT_KEY_2)
						MATRIX_KEY(1, 0, INPUT_KEY_3)
						MATRIX_KEY(1, 1, INPUT_KEY_4)>;
			row-size = <2>;
			col-size = <2>;
		};
	};

	/delete-node/ keys;
	/delete-node/ key_pool;
	/delete-node/ key_matrix;

	aliases {
		/delete-property/ sw0;
		/delete-property/ sw1;
		/delete-property/ sw2;
		/delete-property/ sw3;
		/delete-property/ mcuboot-button0;
	};
};
```

## src/main.c
```c
/*
 * Copyright (c) 2026 Telink Semiconductor
 *
 * SPDX-License-Identifier: Apache-2.0
 */

#include <zephyr/logging/log.h>
LOG_MODULE_REGISTER(main, LOG_LEVEL_DBG);

#include <zephyr/input/input.h>

static void input_callback(struct input_event *evt, void *user_data)
{
	LOG_INF("key code %u %s", evt->code, evt->value ? "pressed" : "released");
}

INPUT_CALLBACK_DEFINE(DEVICE_DT_GET(DT_NODELABEL(kbd_keymap)), input_callback, NULL);

int main(void)
{
	LOG_INF("press any key");
}
```
