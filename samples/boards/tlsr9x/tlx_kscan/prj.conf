## CMakeLists.txt
```
# SPDX-License-Identifier: Apache-2.0

cmake_minimum_required(VERSION 3.20.0)
find_package(Zephyr REQUIRED HINTS $ENV{ZEPHYR_BASE})
project(kscan-drv)

target_sources(app PRIVATE src/main.c)
```

## prj.conf
```kconfig
CONFIG_LOG=y
CONFIG_LOG_MODE_MINIMAL=y
CONFIG_INPUT=y
```

## boards/tl3228x.overlay
```dts
/ {
	/delete-node/ keys;
	/delete-node/ key_pool;
	/delete-node/ key_matrix;

	aliases {
		/delete-property/ sw0;
		/delete-property/ sw1;
		/delete-property/ sw2;
		/delete-property/ sw3;
		/delete-property/ mcuboot-button0;
	};
};

&tlx_kscan {
	status = "okay";
};
```

## src/main.c
```c
/*
 * Copyright (c) 2026 Telink Semiconductor
 *
 * SPDX-License-Identifier: Apache-2.0
 */

#include <zephyr/logging/log.h>

LOG_MODULE_REGISTER(main, LOG_LEVEL_DBG);

#include <zephyr/input/input.h>

static void input_callback(struct input_event *evt, void *user_data)
{
	ARG_UNUSED(user_data);
	LOG_INF("%s key (%u %u) %s", evt->dev->name, (evt->code >> 8) & 0xff, evt->code & 0xff,
		evt->value ? "pressed" : "released");
}

INPUT_CALLBACK_DEFINE(DEVICE_DT_GET(DT_NODELABEL(tlx_kscan)), input_callback, NULL);

int main(void)
{
	LOG_INF("press any key");
	return 0;
}
```
