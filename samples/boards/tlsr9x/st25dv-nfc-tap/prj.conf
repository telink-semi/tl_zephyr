## CMakeLists.txt
```
#
# Copyright (c) 2026 Telink Semiconductor
#
# SPDX-License-Identifier: Apache-2.0
#

cmake_minimum_required(VERSION 3.20.0)

find_package(Zephyr REQUIRED HINTS $ENV{ZEPHYR_BASE})
project(st25dv-nfc-tap)

target_sources(app PRIVATE
	src/main.c
)
```

## Kconfig
```
#
# Copyright (c) 2026 Telink Semiconductor
#
# SPDX-License-Identifier: Apache-2.0
#

choice APPLICATION_TYPE
	default APPLICATION_TYPE_ST25DV_MAILBOX
	prompt "Application type"

config APPLICATION_TYPE_ST25DV_MAILBOX
	bool "Application type ST25DV mailbox"
config APPLICATION_TYPE_ST25DV_STATIC_TAG_ADD
	bool "Application type ST25DV static tag publish"
config APPLICATION_TYPE_ST25DV_STATIC_TAG_RM
	bool "Application type ST25DV static tag withdraw"
config APPLICATION_TYPE_ST25DV_NONE
	bool "Application does nothing (to check past radio off state)"

endchoice

source "Kconfig.zephyr"
```

## prj.conf
```kconfig
#
# Copyright (c) 2026 Telink Semiconductor
#
# SPDX-License-Identifier: Apache-2.0
#

CONFIG_LOG=y
CONFIG_LOG_MODE_MINIMAL=y

CONFIG_ST25DV=y
CONFIG_ST25DV_LOG_LEVEL_DBG=y
```

## app.overlay
```dts
/*
 * Copyright (c) 2026 Telink Semiconductor
 *
 * SPDX-License-Identifier: Apache-2.0
 */

/ {
	st25dv_app: st25dv {
		compatible = "st25dv";
		i2c-bus = <&i2c>;
		isr-port = <&gpioe>;
		isr-port-pin = <5>;
	};
};

&i2c {
	status = "okay";
	pinctrl-0 = < &i2c_scl_pe6_default &i2c_sda_pe7_default >;
};

&gpioe {
	status = "okay";
};
```

## boards/tl7218x.overlay
```dts
/*
 * Copyright (c) 2026 Telink Semiconductor
 *
 * SPDX-License-Identifier: Apache-2.0
 */

/ {
	st25dv_app: st25dv {
		compatible = "st25dv";
		i2c-bus = <&i2c>;
		isr-port = <&gpioe>;
		isr-port-pin = <5>;
	};
};

&i2c {
	status = "okay";
	pinctrl-0 = < &i2c_scl_pe6_default &i2c_sda_pe7_default >;
};

&gpioe {
	interrupts = <27 1>;
	status = "okay";
};
```

## dts/bindings/st25dv.yaml
```yaml
#
# Copyright (c) 2026 Telink Semiconductor
#
# SPDX-License-Identifier: Apache-2.0
#

description: Dynamic NFC/RFID tag IC
compatible: "st25dv"

properties:
  i2c-bus:
    type: phandle
    required: true
  isr-port:
    type: phandle
    required: true
  isr-port-pin:
    type: int
    required: true
```

## src/main.c
```c
/*
 * Copyright (c) 2026 Telink Semiconductor
 *
 * SPDX-License-Identifier: Apache-2.0
 *
 * Zephyr ST25DVXXKC mailbox driver demonstration use android ST25 application to interact
 */

#include <st25dv.h>

#include <zephyr/logging/log.h>

LOG_MODULE_REGISTER(main, LOG_LEVEL_INF);

struct application_data {
	struct st25dv_data *nfc_dev;
	struct k_sem *run_sem;
};

static const char *st25dv_mode_str(struct st25dv_data *data)
{
	const char *result = "unavailable";
	int mode = st25dv_mode_get(data);

	if (mode >= ST25DV_MODE_OFF && mode <= ST25DV_MODE_MAILBOX) {
		static const char * const mode_str[] = {
			"switched off",
			"nfc tag",
			"mailbox",
		};
		result = mode_str[mode];
	}

	return result;
}

static void nfc_dev_on_event(enum st25dv_event event, void *ctx, uint8_t *buf, size_t buf_len)
{
	struct application_data *app_data = (struct application_data *)ctx;

	switch (event) {
	case ST25DV_EVENT_FIELD_ON:
		LOG_INF("nfc device field on");
		break;
	case ST25DV_EVENT_FIELD_OFF:
		LOG_INF("nfc device field off");
		break;
	case ST25DV_EVENT_DATA_RECEIVED:
		LOG_HEXDUMP_INF(buf, buf_len, "nfc device rx");
		if (buf_len == 1 && buf[0] == 0x00) {
			LOG_HEXDUMP_INF(buf, buf_len, "application exit");
			k_sem_give(app_data->run_sem);
		} else if (buf_len == 1 && buf[0] == 0x01) {
			LOG_HEXDUMP_INF(buf, buf_len, "nfc device write tag");

			const uint8_t tag_data[] = {0xd1, 0x01, 0x0f, 0x54, 0x02, 0x65, 0x6e,
						    0x48, 0x65, 0x6c, 0x6c, 0x6f, 0x20, 0x57,
						    0x6f, 0x72, 0x6c, 0x64, 0x21};
			int result =
				st25dv_tag_type5_add(app_data->nfc_dev, tag_data, sizeof(tag_data));

			if (result) {
				LOG_ERR("nfc device tag data add failed %d", result);
			} else {
				LOG_INF("nfc device tag data set");
			}
		} else if (buf_len == 1 && buf[0] == 0x02) {
			LOG_HEXDUMP_INF(buf, buf_len, "nfc device erase tag");

			int result = st25dv_tag_type5_rm(app_data->nfc_dev);

			if (result) {
				LOG_ERR("nfc device tag remove failed %d", result);
			} else {
				LOG_INF("nfc device tag data erased");
			}
		} else if (buf_len == 1 && buf[0] == 0x03) {
			LOG_HEXDUMP_INF(buf, buf_len, "nfc device switch to tag mode");

			int result = st25dv_mode_set(app_data->nfc_dev, ST25DV_MODE_TAG);

			if (result) {
				LOG_ERR("nfc device switch to tag failed %d", result);
			} else {
				LOG_INF("nfc device mode %s", st25dv_mode_str(app_data->nfc_dev));
			}
		} else if (buf_len == 1 && buf[0] == 0x04) {
			LOG_HEXDUMP_INF(buf, buf_len, "nfc device switch off");

			int result = st25dv_mode_set(app_data->nfc_dev, ST25DV_MODE_OFF);

			if (result) {
				LOG_ERR("nfc device switch off failed %d", result);
			} else {
				LOG_INF("nfc device mode %s", st25dv_mode_str(app_data->nfc_dev));
			}
		} else {
			int result = st25dv_mailbox_send(app_data->nfc_dev, buf, buf_len);

			if (result) {
				LOG_ERR("nfc device mailbox send failed %d", result);
			} else {
				LOG_INF("nfc device rx data written back into mailbox");
			}
		}
		break;
	case ST25DV_EVENT_DATA_SENT:
		LOG_INF("nfc device tx");
		break;
	default:
		LOG_WRN("nfc device unknown event %u", event);
	}
}

int main(void)
{
	ST25DV_DATA_DEFINE(app_nfc_dev, st25dv_matter);
	static K_SEM_DEFINE(app_run_sem, 0, 1);
	struct application_data data = {.nfc_dev = &app_nfc_dev, .run_sem = &app_run_sem};
	int result;

	LOG_INF("application started");
	result = st25dv_init(&app_nfc_dev);
	if (result) {
		LOG_ERR("nfc device init failed %d", result);
		return result;
	}
	result = st25dv_mode_set(&app_nfc_dev, ST25DV_MODE_MAILBOX);
	if (result) {
		LOG_ERR("nfc device set mode failed %d", result);
		return result;
	}
	st25dv_set_callback(&app_nfc_dev, nfc_dev_on_event, &data);
	LOG_INF("nfc device mode %s", st25dv_mode_str(&app_nfc_dev));
	LOG_INF("nfc device mailbox data loopback...\n"
		"the next one byte data is reserved for commands\n"
		"0x00 - finish the application (no future commands possible)\n"
		"0x01 - write tag eeprom\n"
		"0x02 - erase tag eeprom\n"
		"0x03 - switch to tag mode (no future commands possible)\n"
		"0x04 - switch off (no future commands possible)\n"
		"commands are not sent back\n");
	(void)k_sem_take(&app_run_sem, K_FOREVER);
	result = st25dv_deinit(&app_nfc_dev);
	if (result) {
		LOG_ERR("nfc device deinit failed %d", result);
	}
	LOG_INF("application finished");

	return result;
}
```

## src/st25dv.c
```c
/*
 * Copyright (c) 2026 Telink Semiconductor
 *
 * SPDX-License-Identifier: Apache-2.0
 */

#include "st25dv.h"
#include <zephyr/drivers/i2c.h>
#include <zephyr/drivers/gpio.h>

#include <zephyr/logging/log.h>

#define MODULE_NAME st25dv
LOG_MODULE_REGISTER(MODULE_NAME, CONFIG_ST25DV_LOG_LEVEL);

#define ST25DV_USER_MEMORY_ADDR 0x53
#define ST25DV_SYSTEM_AREA_ADDR 0x57
#define ST25DV_MBOX_LENGTH_MAX  255

#define ST25DV_REG_SYS_IC_REF      0x0017
#define ST25DV_REG_SYS_IC_REV      0x0020
#define ST25DV_REG_USR_MB_CTRL_DYN 0x2006
#define ST25DV_REG_USR_GPO_DYN     0x2000
#define ST25DV_REG_USR_MB_DATA_DYN 0x2008
#define ST25DV_REG_SYS_I2C_PWD     0x0900
#define ST25DV_REG_SYS_MB_MODE     0x000d
#define ST25DV_REG_SYS_CONFIG      0x0018

static const char *st25dv_module_name = STRINGIFY(MODULE_NAME);
static const uint8_t st25dv_chip_ref[] = {0x51, 0x50};

static void st25dv_isr_handler(const struct device *port, struct gpio_callback *cb,
			       gpio_port_pins_t pins);
static void st25dv_work_handler(struct k_work *item);

int st25dv_probe(struct st25dv_data *data)
{
	int result;

	do {
		LOG_DBG("%s %s", st25dv_module_name, __func__);

		uint8_t chip_ref, chip_rev;

		result = i2c_write_read(data->i2c_bus, ST25DV_SYSTEM_AREA_ADDR,
					(uint8_t[]){
						(uint8_t)(ST25DV_REG_SYS_IC_REF >> 8),
						(uint8_t)ST25DV_REG_SYS_IC_REF,
					},
					2, &chip_ref, sizeof(chip_ref));
		if (result) {
			LOG_ERR("%s read chip id failed %d", st25dv_module_name, result);
			break;
		}
		result = -ENODEV;
		for (size_t i = 0; i < ARRAY_SIZE(st25dv_chip_ref); ++i) {
			if (chip_ref == st25dv_chip_ref[i]) {
				result = 0;
				break;
			}
		}
		if (result) {
			LOG_ERR("%s invalid chip id %02x", st25dv_module_name, chip_ref);
			break;
		}
		result = i2c_write_read(data->i2c_bus, ST25DV_SYSTEM_AREA_ADDR,
					(uint8_t[]){
						(uint8_t)(ST25DV_REG_SYS_IC_REV >> 8),
						(uint8_t)ST25DV_REG_SYS_IC_REV,
					},
					2, &chip_rev, sizeof(chip_rev));
		if (result) {
			LOG_ERR("%s read chip id failed %d", st25dv_module_name, result);
			break;
		}
		LOG_INF("%s chip id %02x rev %02x", st25dv_module_name, chip_ref, chip_rev);
	} while (0);

	return result;
}

int st25dv_unlock(struct st25dv_data *data)
{
	int result;

	do {
		LOG_DBG("%s %s", st25dv_module_name, __func__);

		/* TODO: Set static regs: GPO, MB */
		result = 0;
	} while (0);

	return result;
}

int st25dv_reset(struct st25dv_data *data)
{
	int result;

	do {
		LOG_DBG("%s %s", st25dv_module_name, __func__);
		result = i2c_write(data->i2c_bus,
				   (uint8_t[]){
					   (uint8_t)(ST25DV_REG_USR_MB_CTRL_DYN >> 8),
					   (uint8_t)ST25DV_REG_USR_MB_CTRL_DYN,
					   0x00, /* bit 0: MB_EN = 1 */
				   },
				   3, ST25DV_USER_MEMORY_ADDR);
		if (result) {
			LOG_ERR("%s mailbox switching off failed %d", st25dv_module_name, result);
			break;
		}
		result = i2c_write(data->i2c_bus,
				   (uint8_t[]){
					   (uint8_t)(ST25DV_REG_USR_GPO_DYN >> 8),
					   (uint8_t)ST25DV_REG_USR_GPO_DYN,
					   0x00, /* bit 0: GPO_Enable */
				   },
				   3, ST25DV_USER_MEMORY_ADDR);
		if (result) {
			LOG_ERR("%s clear isr config failed %d", st25dv_module_name, result);
			break;
		}
	} while (0);

	return result;
}

int st25dv_init(struct st25dv_data *data)
{
	int result = -EALREADY;

	do {
		LOG_DBG("%s %s", st25dv_module_name, __func__);
		if (data->inited) {
			break;
		}
		result = -ENODEV;
		if (!device_is_ready(data->i2c_bus)) {
			LOG_ERR("%s device %s not ready", st25dv_module_name, data->i2c_bus->name);
			break;
		}
		if (!device_is_ready(data->isr_port)) {
			LOG_ERR("%s device %s not ready", st25dv_module_name, data->isr_port->name);
			break;
		}
		result = st25dv_probe(data);
		if (result) {
			LOG_ERR("%s not detected on i2c bus", st25dv_module_name);
			break;
		}
		result = st25dv_unlock(data);
		if (result) {
			LOG_ERR("%s unlock failed", st25dv_module_name);
			break;
		}
		result = st25dv_reset(data);
		if (result) {
			LOG_ERR("%s reset failed", st25dv_module_name);
			break;
		}
		k_work_init(&data->work, st25dv_work_handler);
		result = gpio_pin_configure(data->isr_port, data->isr_port_pin,
					    GPIO_INPUT | GPIO_PULL_UP | GPIO_ACTIVE_LOW);
		if (result) {
			LOG_ERR("%s gpio setup failed %d", st25dv_module_name, result);
			break;
		}
		gpio_init_callback(&data->gpio_cb, st25dv_isr_handler, BIT(data->isr_port_pin));
		result = gpio_add_callback(data->isr_port, &data->gpio_cb);
		if (result) {
			LOG_ERR("%s add gpio callback failed %d", st25dv_module_name, result);
			break;
		}
		result = gpio_pin_interrupt_configure(data->isr_port, data->isr_port_pin,
						      GPIO_INT_EDGE_TO_ACTIVE);
		if (result) {
			LOG_ERR("%s gpio isr setup failed %d", st25dv_module_name, result);
			break;
		}
		result = i2c_write(data->i2c_bus,
				   (uint8_t[]){
					   (uint8_t)(ST25DV_REG_USR_GPO_DYN >> 8),
					   (uint8_t)ST25DV_REG_USR_GPO_DYN,
					   0x01, /* bit 0: GPO_Enable */
				   },
				   3, ST25DV_USER_MEMORY_ADDR);
		if (result) {
			LOG_ERR("%s gpo register config failed %d", st25dv_module_name, result);
			break;
		}
		result = i2c_write(data->i2c_bus,
				   (uint8_t[]){
					   (uint8_t)(ST25DV_REG_USR_MB_CTRL_DYN >> 8),
					   (uint8_t)ST25DV_REG_USR_MB_CTRL_DYN,
					   0x01, /* bit 0: MB_EN = 1 */
				   },
				   3, ST25DV_USER_MEMORY_ADDR);
		if (result) {
			LOG_ERR("%s enable mailbox failed %d", st25dv_module_name, result);
			break;
		}
		data->inited = true;
		LOG_DBG("%s init ok", st25dv_module_name);
	} while (0);

	return result;
}

int st25dv_deinit(struct st25dv_data *data)
{
	int result = -EALREADY;

	do {
		LOG_DBG("%s %s", st25dv_module_name, __func__);
		if (!data->inited) {
			break;
		}
		result = st25dv_reset(data);
		if (result) {
			LOG_ERR("%s reset failed", st25dv_module_name);
			break;
		}
		result = gpio_pin_interrupt_configure(data->isr_port, data->isr_port_pin,
						      GPIO_INT_DISABLE);
		if (result) {
			LOG_ERR("%s gpio isr disable failed", st25dv_module_name);
			break;
		}
		result = gpio_remove_callback(data->isr_port, &data->gpio_cb);
		if (result) {
			LOG_ERR("%s rm gpio callback failed", st25dv_module_name);
			break;
		}
		result = gpio_pin_configure(data->isr_port, data->isr_port_pin, GPIO_DISCONNECTED);
		if (result) {
			LOG_ERR("%s gpio disable failed", st25dv_module_name);
			break;
		}

		struct k_work_sync sync_handle;

		(void)k_work_cancel_sync(&data->work, &sync_handle);
		data->inited = false;
		LOG_DBG("%s deinit ok", st25dv_module_name);
	} while (0);

	return result;
}

int st25dv_mailbox_send(struct st25dv_data *data, const void *buf, size_t buf_len)
{
	int result = -EINVAL;

	do {
		LOG_DBG("%s %s", st25dv_module_name, __func__);
		if (!buf || !buf_len || buf_len > ST25DV_MBOX_LENGTH_MAX) {
			LOG_ERR("%s invalid data send", st25dv_module_name);
			break;
		}
		if (!data->inited) {
			result = -ENODEV;
			LOG_ERR("%s not inited", st25dv_module_name);
			break;
		}

		uint8_t ctrl_reg;

		result = i2c_write_read(data->i2c_bus, ST25DV_USER_MEMORY_ADDR,
					(uint8_t[]){
						(uint8_t)(ST25DV_REG_USR_MB_CTRL_DYN >> 8),
						(uint8_t)ST25DV_REG_USR_MB_CTRL_DYN,
					},
					2, &ctrl_reg, sizeof(ctrl_reg));
		if (result) {
			LOG_ERR("%s mailbox status failed %d", st25dv_module_name, result);
			break;
		}
		if (!(ctrl_reg & 0x01)) { /* bit 0: MB_EN = 1 */
			result = -EIO;
			LOG_ERR("%s mailbox disabled", st25dv_module_name);
			break;
		}
		if (ctrl_reg & 0x06) { /* bit 1: HOST_PUT_MSG = 1, bit 2: RF_PUT_MSG = 1 */
			result = -EBUSY;
			LOG_ERR("%s mailbox busy %x", st25dv_module_name, ctrl_reg & 0x06);
			break;
		}

		uint8_t mbox_data[2 + buf_len];

		mbox_data[0] = (uint8_t)(ST25DV_REG_USR_MB_DATA_DYN >> 8);
		mbox_data[1] = (uint8_t)ST25DV_REG_USR_MB_DATA_DYN;
		memcpy(&mbox_data[2], buf, buf_len);
		result = i2c_write(data->i2c_bus, mbox_data, sizeof(mbox_data),
				   ST25DV_USER_MEMORY_ADDR);
		if (result) {
			LOG_ERR("%s mailbox send failed %d", st25dv_module_name, result);
			break;
		}
		LOG_DBG("%s mailbox send ok", st25dv_module_name);
	} while (0);

	return result;
}

static void st25dv_isr_handler(const struct device *port, struct gpio_callback *cb,
			       gpio_port_pins_t pins)
{
	struct st25dv_data *data = CONTAINER_OF(cb, struct st25dv_data, gpio_cb);

	/* LOG_DBG("%s isr %s", st25dv_module_name, data->i2c_bus->name); */
	k_work_submit(&data->work);
}

static void st25dv_work_handler(struct k_work *item)
{
	struct st25dv_data *data = CONTAINER_OF(item, struct st25dv_data, work);

	LOG_DBG("%s work %s", st25dv_module_name, data->i2c_bus->name);
	/* TODO: read input mailbox */
}
```

## src/st25dv.h
```c
/*
 * Copyright (c) 2026 Telink Semiconductor
 *
 * SPDX-License-Identifier: Apache-2.0
 */

#ifndef ST25DV_H
#define ST25DV_H

#include <zephyr/device.h>
#include <zephyr/drivers/gpio.h>

struct st25dv_data {
	const struct device *const i2c_bus;
	const struct device *const isr_port;
	const uint8_t isr_port_pin;
	bool inited;
	struct gpio_callback gpio_cb;
	struct k_work work;
};

#define ST25DV_DATA_DEFINE(name, st25dv_node_label)                                                \
	struct st25dv_data name = {                                                                \
		.i2c_bus = DEVICE_DT_GET(DT_PHANDLE(DT_NODELABEL(st25dv_node_label), i2c_bus)),    \
		.isr_port = DEVICE_DT_GET(DT_PHANDLE(DT_NODELABEL(st25dv_node_label), isr_port)),  \
		.isr_port_pin = DT_PROP(DT_NODELABEL(st25dv_node_label), isr_port_pin),            \
	}

int st25dv_probe(struct st25dv_data *data);
int st25dv_unlock(struct st25dv_data *data);
int st25dv_reset(struct st25dv_data *data);
int st25dv_init(struct st25dv_data *data);
int st25dv_deinit(struct st25dv_data *data);
int st25dv_mailbox_send(struct st25dv_data *data, const void *buffer, size_t len);

#endif /* ST25DV_H */
```
