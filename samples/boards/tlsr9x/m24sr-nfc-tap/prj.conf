## CMakeLists.txt
```
#
# Copyright (c) 2026 Telink Semiconductor
#
# SPDX-License-Identifier: Apache-2.0
#

cmake_minimum_required(VERSION 3.20.0)

find_package(Zephyr REQUIRED HINTS $ENV{ZEPHYR_BASE})
project(m24sr-nfc-tap)

target_sources(app PRIVATE
	src/main.c
)
```

## prj.conf
```kconfig
#
# Copyright (c) 2026 Telink Semiconductor
#
# SPDX-License-Identifier: Apache-2.0
#

CONFIG_LOG=y
CONFIG_LOG_MODE_MINIMAL=y

CONFIG_M24SR=y
CONFIG_M24SR_LOG_LEVEL_INF=y
```

## src/main.c
```c
/*
 * Copyright (c) 2026 Telink Semiconductor
 *
 * SPDX-License-Identifier: Apache-2.0
 *
 * Zephyr M24SR driver demonstration.
 * use next android application on your smartphone
 * https://play.google.com/store/apps/details?id=com.nxp.taginfolite
 */

#include <m24sr.h>
#include <m24sr_ext.h>

#include <zephyr/sys/byteorder.h>
#include <zephyr/kernel.h>

#include <zephyr/logging/log.h>

LOG_MODULE_REGISTER(main, LOG_LEVEL_INF);

#define MAX_APDU_SIZE 261

static void nfc_event_callback(void *ctx)
{
	do {
		LOG_INF("m24sr gpo callback triggered (smartphone sent data)");

		uint16_t result;
		uint16_t apdu_len;

		result = M24SR_ReadBinary(M24SR_I2C_ADDRESS, 0, sizeof(apdu_len),
					  (uint8_t *)&apdu_len);
		if (result != M24SR_ACTION_COMPLETED) {
			LOG_ERR("m24sr read apdu length failed %x", result);
			break;
		}
		apdu_len = sys_be16_to_cpu(apdu_len);
		if (!apdu_len) {
			LOG_INF("m24sr data sent");
			break;
		}
		if (apdu_len > MAX_APDU_SIZE - sizeof(apdu_len)) {
			LOG_ERR("m24sr income apdu length failed %u", apdu_len);
			break;
		}

		uint8_t apdu_data[sizeof(apdu_len) + apdu_len];

		result = M24SR_ReadBinary(M24SR_I2C_ADDRESS, sizeof(apdu_len),
					  sizeof(apdu_data) - sizeof(apdu_len),
					  &apdu_data[sizeof(apdu_len)]);
		if (result != M24SR_ACTION_COMPLETED) {
			LOG_ERR("m24sr read apdu data failed %x", result);
			break;
		}
		*(uint16_t *)apdu_data = sys_cpu_to_be16(apdu_len);
		LOG_HEXDUMP_INF(apdu_data, sizeof(apdu_data), "income apdu");

		uint8_t apdu_response[] = {0x90, 0x00};

		result = M24SR_UpdateBinary(M24SR_I2C_ADDRESS, 0, sizeof(apdu_response),
					    apdu_response);
		if (result != M24SR_ACTION_COMPLETED) {
			LOG_ERR("m24sr write apdu data failed %x", result);
			break;
		}
		LOG_INF("m24sr response apdu [90 00] sent successfully");
	} while (0);
}

int main(void)
{
	uint16_t result;

	do {
		LOG_INF("m24sr test app...");
		M24SR_Init(M24SR_I2C_ADDRESS, M24SR_GPO_INTERRUPT);
		result = M24SR_GetSession(M24SR_I2C_ADDRESS);
		if (result != M24SR_ACTION_COMPLETED) {
			LOG_ERR("m24sr get session failed %x", result);
			break;
		}
		result = M24SR_ManageI2CGPO(M24SR_I2C_ADDRESS, M24SR_GPO_MODE_HIGH_IMPEDANCE);
		if (result != M24SR_ACTION_COMPLETED) {
			LOG_ERR("m24sr disabling i2c interrupts failed %x", result);
			break;
		}
		result = M24SR_ManageRFGPO(M24SR_I2C_ADDRESS, M24SR_GPO_MODE_WIP);
		if (result != M24SR_ACTION_COMPLETED) {
			LOG_ERR("m24sr setup gpo failed %x", result);
			break;
		}
		/* M24SR_Deselect(M24SR_I2C_ADDRESS); ??? */
		M24SR_SetEventHandler(nfc_event_callback, NULL);
		M24SR_RFConfig(1);
		LOG_INF("m24sr nfc system ready. please scan the tag with your android phone...");
		for (;;) {
			k_sleep(K_FOREVER);
		}
	} while (0);
	return result;
}
```
