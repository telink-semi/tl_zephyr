## CMakeLists.txt
```
# Copyright (c) 2025 Telink Semiconductor
# SPDX-License-Identifier: Apache-2.0

cmake_minimum_required(VERSION 3.20.0)

find_package(Zephyr REQUIRED HINTS $ENV{ZEPHYR_BASE})
project(telink_otbr)

if (NOT CONFIG_SOC_RISCV_TELINK_W91)
  message(FATAL_ERROR "SOC is not supported for this sample")
endif()

target_sources(app PRIVATE
  src/main.c
)
```

## prj.conf
```kconfig
# Copyright (c) 2025 Telink Semiconductor
# SPDX-License-Identifier: Apache-2.0

# enable thread border router
CONFIG_TELINK_OTBR=y

# logging & shell
CONFIG_LOG=y
CONFIG_LOG_MODE_MINIMAL=y
CONFIG_SHELL_BACKEND_TELINK_W91=n
CONFIG_SHELL_BACKEND_TELNET=y
CONFIG_NET_SHELL=y
CONFIG_NET_TCP=y
CONFIG_SHELL_VT100_COMMANDS=n
CONFIG_POSIX_MAX_FDS=6

# thread features
CONFIG_OPENTHREAD_THREAD_VERSION_1_3=y
CONFIG_OPENTHREAD_SRP_CLIENT=y
CONFIG_OPENTHREAD_JOINER=y
CONFIG_OPENTHREAD_LINK_METRICS_SUBJECT=y
CONFIG_OPENTHREAD_COMMISSIONER=y
CONFIG_OPENTHREAD_PING_SENDER=y
CONFIG_OPENTHREAD_DHCP6_CLIENT=y
CONFIG_OPENTHREAD_DNS_CLIENT=y
CONFIG_OPENTHREAD_REFERENCE_DEVICE=y
CONFIG_OPENTHREAD_MLR=y
CONFIG_OPENTHREAD_MAC_FILTER=y
CONFIG_OPENTHREAD_DUA=y
CONFIG_OPENTHREAD_COAP=y
CONFIG_OPENTHREAD_COAPS=y
CONFIG_MBEDTLS_PEM_CERTIFICATE_FORMAT=y
CONFIG_OPENTHREAD_NUM_MESSAGE_BUFFERS=350
CONFIG_OPENTHREAD_CSL_RECEIVE_TIME_AHEAD=480
# CONFIG_NET_PKT_TXTIME=y
# CONFIG_NET_PKT_TIMESTAMP=y

# wifi-credentials
CONFIG_TELINK_OTBR_WIFI_SSID="TLNK-2.4G"
CONFIG_TELINK_OTBR_WIFI_PASSWORD="temporary1"

# thread network credentials
CONFIG_OPENTHREAD_CHANNEL=18
CONFIG_OPENTHREAD_PANID=5144
CONFIG_OPENTHREAD_XPANID="ff:0d:b8:00:00:00:00:00"
CONFIG_OPENTHREAD_NETWORKKEY="ff:11:22:33:44:55:66:77:88:99:aa:bb:cc:dd:ee:ff"
CONFIG_OPENTHREAD_NETWORK_NAME="telink-ot"
```

## src/main.c
```c
/*
 * Copyright (c) 2025 Telink
 *
 * SPDX-License-Identifier: Apache-2.0
 */

#include <zephyr/logging/log.h>
LOG_MODULE_REGISTER(main, LOG_LEVEL_INF);

int main(void)
{
	LOG_INF("***** Telink Thread Border Router *****");
	return 0;
}
```
