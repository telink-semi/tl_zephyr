## CMakeLists.txt
```
# Copyright (c) 2026 Telink Semiconductor
# SPDX-License-Identifier: Apache-2.0

cmake_minimum_required(VERSION 3.20.0)

# set default overlay
file(GLOB telink_ot_lib_configs
	"overlays/*.conf"
)
if(NOT DEFINED OVERLAY_CONFIG)
	message(WARNING "***Not set OT Telink library overlay, default used***")
	list(GET telink_ot_lib_configs 0 OVERLAY_CONFIG_PATH)
	cmake_path(RELATIVE_PATH OVERLAY_CONFIG_PATH)
	set(OVERLAY_CONFIG "${OVERLAY_CONFIG_PATH}" CACHE STRING "")
else()
	set(OVERLAY_CONFIG_PATH "${OVERLAY_CONFIG}")
	cmake_path(ABSOLUTE_PATH OVERLAY_CONFIG_PATH)
	if(NOT EXISTS "${OVERLAY_CONFIG_PATH}")
		message(WARNING "***Invalid OT Telink library overlay, default used***")
		list(GET telink_ot_lib_configs 0 OVERLAY_CONFIG_PATH)
		cmake_path(RELATIVE_PATH OVERLAY_CONFIG_PATH)
		set(OVERLAY_CONFIG "${OVERLAY_CONFIG_PATH}" CACHE STRING "" FORCE)
	endif()
endif()

# split project configuration
set(CONF_FILE
    ${CMAKE_CURRENT_SOURCE_DIR}/prj.conf
    ${CMAKE_CURRENT_SOURCE_DIR}/openthread.conf
)

# use compilation wrapper
set(CMAKE_C_COMPILER_LAUNCHER ${CMAKE_BINARY_DIR}/scripts/exec-wrap CACHE STRING "" FORCE)
set(CMAKE_CXX_COMPILER_LAUNCHER ${CMAKE_BINARY_DIR}/scripts/exec-wrap CACHE STRING "" FORCE)
set(CMAKE_ASM_COMPILER_LAUNCHER ${CMAKE_BINARY_DIR}/scripts/exec-wrap CACHE STRING "" FORCE)

find_package(Zephyr REQUIRED HINTS $ENV{ZEPHYR_BASE})
project(telink_ot_lib)

message(STATUS "***OT Telink library overlay: ${OVERLAY_CONFIG}***")

# dummy to trigger build process
target_sources(app PRIVATE src/main.c)

add_custom_target(post_build ALL
	COMMAND "${CMAKE_CURRENT_SOURCE_DIR}/scripts/post-build" ${CMAKE_BINARY_DIR} ${CMAKE_STRIP}
)

add_dependencies(post_build zephyr_final)

# deterministic build
message(STATUS "***OT Telink library build time: ${CONFIG_TELINK_OT_LIB_BUILD_TIMESTAMP}***")
set(TELINK_OT_LIB_BUILD_TIMESTAMP "${CONFIG_TELINK_OT_LIB_BUILD_TIMESTAMP}")
configure_file(
	${CMAKE_SOURCE_DIR}/scripts/exec-wrap.in
	${CMAKE_BINARY_DIR}/scripts/exec-wrap
	@ONLY
)
file(CHMOD ${CMAKE_BINARY_DIR}/scripts/exec-wrap PERMISSIONS OWNER_EXECUTE OWNER_WRITE OWNER_READ)

set(CMAKE_C_ARCHIVE_CREATE "<CMAKE_AR> qcD <TARGET> <OBJECTS>")
set(CMAKE_C_ARCHIVE_APPEND "<CMAKE_AR> qD <TARGET> <OBJECTS>")
set(CMAKE_C_ARCHIVE_FINISH "<CMAKE_RANLIB> -D <TARGET>")

add_compile_options(
	-ffile-prefix-map=${CMAKE_SOURCE_DIR}=.
	-fdebug-prefix-map=${CMAKE_SOURCE_DIR}=.
)

add_compile_options(-frandom-seed=0)

add_link_options(
	-Wl,--build-id=none
)

# create target to install headers (west build -t ot-headers)
add_custom_target(ot-headers
	COMMAND ${CMAKE_COMMAND} -E make_directory ${CMAKE_BINARY_DIR}/zephyr/ot-include
	COMMAND ${CMAKE_COMMAND} -E make_directory ${CMAKE_BINARY_DIR}/zephyr/ot-include/utils
	COMMAND ${CMAKE_COMMAND}
		-D SRC_DIR="${ZEPHYR_OPENTHREAD_MODULE_DIR}/include"
		-D DEST_DIR="${CMAKE_BINARY_DIR}/zephyr/ot-include"
		-D FILE_MASK="*.h"
		-P "${CMAKE_CURRENT_SOURCE_DIR}/scripts/copy_directory_mask.cmake"
	COMMAND ${CMAKE_COMMAND} -E copy
		${ZEPHYR_OPENTHREAD_MODULE_DIR}/examples/platforms/openthread-system.h
		${CMAKE_BINARY_DIR}/zephyr/ot-include
	COMMAND ${CMAKE_COMMAND} -E copy
		${ZEPHYR_OPENTHREAD_MODULE_DIR}/examples/platforms/utils/uart.h
		${CMAKE_BINARY_DIR}/zephyr/ot-include/utils
	COMMAND ${CMAKE_COMMAND} -E echo "Headers path: ${CMAKE_BINARY_DIR}/zephyr/ot-include"
	COMMENT "Install openthread headers"
)
```

## Kconfig
```
# Copyright (c) 2026 Telink Semiconductor
# SPDX-License-Identifier: Apache-2.0

menu "OpenThread Telink library"

config TELINK_OT_LIB_BUILD_TIMESTAMP
	int "Telink openthread library build timestamp"
	default 1767218400

endmenu

source "Kconfig.zephyr"
```

## prj.conf
```kconfig
# Copyright (c) 2026 Telink Semiconductor
# SPDX-License-Identifier: Apache-2.0

CONFIG_NETWORKING=y
CONFIG_SHELL=y

# make ot cli library
# do not move to openthread config
# it's enabled during library build
# but in project it's user controllable -
# thrown away due to entry point
CONFIG_OPENTHREAD_SHELL=y
```

## openthread.conf
```kconfig
# Copyright (c) 2026 Telink Semiconductor
# SPDX-License-Identifier: Apache-2.0

# enable openthread
CONFIG_NET_L2_OPENTHREAD=y
# required openthread version
CONFIG_OPENTHREAD_THREAD_VERSION_1_4=y
# Telink platform required (more than 1mS due to architecture, lower better)
CONFIG_OPENTHREAD_CSL_RECEIVE_TIME_AHEAD=2000
CONFIG_OPENTHREAD_CSL_REQUEST_TIME_AHEAD=2000
```

## src/main.c
```c
/*
 * Copyright (c) 2026 Telink
 *
 * SPDX-License-Identifier: Apache-2.0
 */

int main(void)
{
	return 0;
}
```
