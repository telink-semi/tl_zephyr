## prj.conf
```kconfig
# general project configuration
# UART/console and logging are disabled to keep the wake-up current low.
CONFIG_LOG=n
CONFIG_SERIAL=n
CONFIG_CONSOLE=n
CONFIG_UART_CONSOLE=n
CONFIG_NETWORKING=y
CONFIG_NET_L2_OPENTHREAD=y

# thread features
CONFIG_OPENTHREAD_THREAD_VERSION_1_4=y
CONFIG_OPENTHREAD_SLAAC=y
CONFIG_OPENTHREAD_DNS_CLIENT=y
CONFIG_OPENTHREAD_ECDSA=y
CONFIG_OPENTHREAD_SRP_CLIENT=y
CONFIG_OPENTHREAD_DEFAULT_TX_POWER=3

# kernel and stdlib heap
CONFIG_HEAP_MEM_POOL_SIZE=1024
CONFIG_COMMON_LIBC_MALLOC_ARENA_SIZE=2048

# enable power management
CONFIG_PM=y

# SED device with its poll interval
CONFIG_OPENTHREAD_MTD=y
CONFIG_OPENTHREAD_MTD_SED=y
CONFIG_OPENTHREAD_POLL_PERIOD=1000

# sync matter light-switch configurations
CONFIG_OPENTHREAD_SLAAC=y
CONFIG_OPENTHREAD_DNS_CLIENT=y
CONFIG_OPENTHREAD_ECDSA=y
CONFIG_OPENTHREAD_SRP_CLIENT=y
CONFIG_OPENTHREAD_DEFAULT_TX_POWER=3

# thread network credentials
CONFIG_OPENTHREAD_CHANNEL=14
CONFIG_OPENTHREAD_PANID=1419
CONFIG_OPENTHREAD_XPANID="11:11:11:11:22:22:44:44"
CONFIG_OPENTHREAD_NETWORKKEY="ff:ee:dd:cc:bb:aa:99:88:77:66:55:44:33:22:11:00"

# Use NVS as settings backend
CONFIG_NVS=y
```

## boards/tl5218x_retention.conf
```kconfig
# Telink 802.15.4 RF optimization
CONFIG_IEEE802154_TL521X_OPTIMIZATION=y

# required by the optimization path (tl521x_wfi_direct -> irq_connect_dynamic)
CONFIG_DYNAMIC_INTERRUPTS=y

# Place the SED standby path (data poll, MAC, radio sleep/receive/transmit)
# in retention RAM instead of flash
CONFIG_OPENTHREAD_SED_RAM_CODE=y
```

## src/main.c
```c
/* main.c - OpenThread */

/*
 * Copyright (c) 2023-2026 Telink
 *
 * SPDX-License-Identifier: Apache-2.0
 */

#include <zephyr/devicetree.h>
#include <zephyr/logging/log.h>
LOG_MODULE_REGISTER(ot_main, LOG_LEVEL_DBG);

#include <zephyr/net/openthread.h>
#include <openthread/thread.h>

/* Consumed by the Telink 802.15.4 driver when
 * CONFIG_IEEE802154_TL521X_OPTIMIZATION is enabled.
 */
volatile bool isThreadCommissioned;

static void ot_show_ip6_addr(otInstance *inst)
{
	const otNetifAddress *ip6_addr = otIp6GetUnicastAddresses(inst);

	for (const otNetifAddress *addr = ip6_addr; addr; addr = addr->mNext) {
		if (addr->mValid) {
			char ip6_str[OT_IP6_ADDRESS_STRING_SIZE];

			otIp6AddressToString(&addr->mAddress, ip6_str, sizeof(ip6_str));
			LOG_INF("ip: %s", ip6_str);
		}
	}
}

static void ot_satate_changed(otChangedFlags flags,
	struct openthread_context *ot_context, void *user_data)
{
	if (flags & OT_CHANGED_THREAD_ROLE) {
		switch (otThreadGetDeviceRole(ot_context->instance)) {
		case OT_DEVICE_ROLE_CHILD:
			isThreadCommissioned = true;
			LOG_INF("OT child");
			LOG_INF("OT Short address: %04x",
				otLinkGetShortAddress(ot_context->instance));
			LOG_HEXDUMP_INF(otLinkGetExtendedAddress(ot_context->instance),
				OT_EXT_ADDRESS_SIZE, "OT Extended address:");
			ot_show_ip6_addr(ot_context->instance);
			break;
		case OT_DEVICE_ROLE_ROUTER:
			LOG_INF("OT router");
			LOG_INF("OT Short address: %04x",
				otLinkGetShortAddress(ot_context->instance));
			LOG_HEXDUMP_INF(otLinkGetExtendedAddress(ot_context->instance),
				OT_EXT_ADDRESS_SIZE, "OT Extended address:");
			ot_show_ip6_addr(ot_context->instance);
			break;
		case OT_DEVICE_ROLE_LEADER:
			LOG_INF("OT leader");
			LOG_INF("OT Short address: %04x",
				otLinkGetShortAddress(ot_context->instance));
			LOG_HEXDUMP_INF(otLinkGetExtendedAddress(ot_context->instance),
				OT_EXT_ADDRESS_SIZE, "OT Extended address:");
			ot_show_ip6_addr(ot_context->instance);
			break;
		case OT_DEVICE_ROLE_DISABLED:
			isThreadCommissioned = false;
			LOG_INF("OT disabled");
			break;
		case OT_DEVICE_ROLE_DETACHED:
			isThreadCommissioned = false;
			LOG_INF("OT detached");
			break;
		default:
			LOG_INF("OT unknown");
			break;
		}
	}
}

int main(void)
{
	LOG_INF("***** OpenThread SED joiner @ F_CPU = %u *****",
		(DT_PROP(DT_PATH(cpus, cpu_0), clock_frequency)));
	LOG_INF("OT channel     %u",     CONFIG_OPENTHREAD_CHANNEL);
	LOG_INF("OT pan id      %04x",   CONFIG_OPENTHREAD_PANID);
	LOG_INF("OT pan ext id  %s",     CONFIG_OPENTHREAD_XPANID);
	LOG_INF("OT network key %s",     CONFIG_OPENTHREAD_NETWORKKEY);

	static struct openthread_state_changed_cb ot_state_cahnge = {
		.state_changed_cb = ot_satate_changed
	};

	openthread_state_changed_cb_register(openthread_get_default_context(), &ot_state_cahnge);

	return 0;
}
```
