## CMakeLists.txt
```
# SPDX-License-Identifier: Apache-2.0

cmake_minimum_required(VERSION 3.20.0)

find_package(Zephyr REQUIRED HINTS $ENV{ZEPHYR_BASE})
project(ot_cli_coexist_with_le_dualmode)

target_sources(app PRIVATE src/main.c)
```

## prj.conf
```kconfig
CONFIG_NETWORKING=y
CONFIG_NET_L2_OPENTHREAD=y

CONFIG_NET_PKT_RX_COUNT=8
CONFIG_NET_PKT_TX_COUNT=8

# Thread v1.3 features
CONFIG_OPENTHREAD_THREAD_VERSION_1_3=y
CONFIG_OPENTHREAD_SRP_CLIENT=y
CONFIG_OPENTHREAD_JOINER=y
CONFIG_OPENTHREAD_LINK_METRICS_SUBJECT=y
CONFIG_OPENTHREAD_BORDER_ROUTER=y
CONFIG_OPENTHREAD_COMMISSIONER=y
CONFIG_OPENTHREAD_PING_SENDER=y
CONFIG_OPENTHREAD_DHCP6_CLIENT=y
CONFIG_OPENTHREAD_DNS_CLIENT=y
CONFIG_OPENTHREAD_SLAAC=y
CONFIG_OPENTHREAD_REFERENCE_DEVICE=y
CONFIG_OPENTHREAD_MLR=y
CONFIG_OPENTHREAD_MAC_FILTER=y
CONFIG_OPENTHREAD_DUA=y
CONFIG_OPENTHREAD_COAP=y
CONFIG_OPENTHREAD_COAPS=y
CONFIG_OPENTHREAD_ENABLE_SERVICE=y
CONFIG_OPENTHREAD_NUM_MESSAGE_BUFFERS=350
CONFIG_OPENTHREAD_CSL_RECEIVE_TIME_AHEAD=480

# Logging & shell
CONFIG_LOG=y
CONFIG_SHELL_VT100_COLORS=n
CONFIG_SHELL_PROMPT_UART=""
CONFIG_SHELL_BACKEND_SERIAL_RX_RING_BUFFER_SIZE=512
CONFIG_NET_SHELL=y
CONFIG_OPENTHREAD_SHELL=y
CONFIG_OPENTHREAD_MANUAL_START=y

# thread network credentials
CONFIG_OPENTHREAD_CHANNEL=26
CONFIG_OPENTHREAD_PANID=1234
CONFIG_OPENTHREAD_XPANID="ff:0d:b8:ff:ff:ff:ff:01"
CONFIG_OPENTHREAD_NETWORKKEY="ff:ee:dd:cc:bb:aa:99:88:77:66:55:44:33:22:11:00"

# openthread
CONFIG_MBEDTLS_PEM_CERTIFICATE_FORMAT=y
CONFIG_COMMON_LIBC_MALLOC_ARENA_SIZE=12288
```

## boards/tl7218x.conf
```kconfig
# usb
CONFIG_USB_DEVICE_STACK=y
CONFIG_USB_DEVICE_INITIALIZE_AT_BOOT=n

# Telink relative thread features
CONFIG_NET_PKT_TXTIME=y
CONFIG_NET_PKT_TIMESTAMP=y
CONFIG_IEEE802154_2015=y
CONFIG_OPENTHREAD_NUM_MESSAGE_BUFFERS=350
CONFIG_IEEE802154_TLX_MAC_FLASH=y
```

## boards/tlsr9528a.conf
```kconfig
# Telink relative thread features
CONFIG_NET_PKT_TXTIME=y
CONFIG_NET_PKT_TIMESTAMP=y
CONFIG_IEEE802154_2015=y
CONFIG_OPENTHREAD_NUM_MESSAGE_BUFFERS=350
```

## src/main.c
```c
/* main.c - OpenThread */

/*
 * Copyright (c) 2023 Telink
 *
 * SPDX-License-Identifier: Apache-2.0
 */

#include <zephyr/logging/log.h>
LOG_MODULE_REGISTER(ot_main, LOG_LEVEL_DBG);

#include <zephyr/net/openthread.h>
#include <openthread/thread.h>

#ifdef CONFIG_USB_DEVICE_STACK
#include <zephyr/usb/usb_device.h>
#endif /* CONFIG_USB_DEVICE_STACK */

static void ot_satate_changed(otChangedFlags flags,
	struct openthread_context *ot_context, void *user_data)
{
	if (flags & OT_CHANGED_THREAD_ROLE) {
		switch (otThreadGetDeviceRole(ot_context->instance)) {
		case OT_DEVICE_ROLE_CHILD:
			LOG_INF("OT child");
			LOG_INF("OT Short address: %04x",
				otLinkGetShortAddress(ot_context->instance));
			LOG_HEXDUMP_INF(otLinkGetExtendedAddress(ot_context->instance),
				OT_EXT_ADDRESS_SIZE, "OT Extended address:");
			break;
		case OT_DEVICE_ROLE_ROUTER:
			LOG_INF("OT router");
			LOG_INF("OT Short address: %04x",
				otLinkGetShortAddress(ot_context->instance));
			LOG_HEXDUMP_INF(otLinkGetExtendedAddress(ot_context->instance),
				OT_EXT_ADDRESS_SIZE, "OT Extended address:");
			break;
		case OT_DEVICE_ROLE_LEADER:
			LOG_INF("OT leader");
			LOG_INF("OT Short address: %04x",
				otLinkGetShortAddress(ot_context->instance));
			LOG_HEXDUMP_INF(otLinkGetExtendedAddress(ot_context->instance),
				OT_EXT_ADDRESS_SIZE, "OT Extended address:");
			break;
		case OT_DEVICE_ROLE_DISABLED:
			LOG_INF("OT disabled");
			break;
		case OT_DEVICE_ROLE_DETACHED:
			LOG_INF("OT detached");
			break;
		default:
			LOG_INF("OT unknown");
			break;
		}
	}
}

void main(void)
{
#ifdef CONFIG_USB_DEVICE_STACK
	usb_enable(NULL);
#endif /* CONFIG_USB_DEVICE_STACK */
	LOG_INF("***** OpenThread CLI + BLE Dualmode on Zephyr *****");
#ifndef CONFIG_OPENTHREAD_MANUAL_START
	LOG_INF("OT channel     %u",     CONFIG_OPENTHREAD_CHANNEL);
	LOG_INF("OT pan id      %04x",   CONFIG_OPENTHREAD_PANID);
	LOG_INF("OT pan ext id  %s",     CONFIG_OPENTHREAD_XPANID);
	LOG_INF("OT network key %s",     CONFIG_OPENTHREAD_NETWORKKEY);
#endif /* CONFIG_OPENTHREAD_MANUAL_START */
	static struct openthread_state_changed_cb ot_state_cahnge = {
		.state_changed_cb = ot_satate_changed
	};

	openthread_state_changed_cb_register(openthread_get_default_context(), &ot_state_cahnge);
}
```
