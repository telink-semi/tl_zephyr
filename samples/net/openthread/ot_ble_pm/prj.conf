## CMakeLists.txt
```
# SPDX-License-Identifier: Apache-2.0

cmake_minimum_required(VERSION 3.20.0)

find_package(Zephyr REQUIRED HINTS $ENV{ZEPHYR_BASE})
project(ot_ble_pm)

target_sources(app PRIVATE src/main.c)
target_sources(app PRIVATE src/le_task.c)
if(CONFIG_BT_TLX_CHANNEL_SOUNDING)
    target_sources(app PRIVATE src/cs_reflector.c)
endif()
```

## prj.conf
```kconfig
# general project configuration
CONFIG_LOG=y
CONFIG_LOG_MODE_MINIMAL=y
CONFIG_NETWORKING=y
CONFIG_NET_L2_OPENTHREAD=y

# thread features
CONFIG_OPENTHREAD_THREAD_VERSION_1_4=y
CONFIG_OPENTHREAD_SLAAC=y
CONFIG_OPENTHREAD_DNS_CLIENT=y
CONFIG_OPENTHREAD_ECDSA=y
CONFIG_OPENTHREAD_SRP_CLIENT=y
CONFIG_OPENTHREAD_DEFAULT_TX_POWER=3

# kernel and stdlib heap
CONFIG_HEAP_MEM_POOL_SIZE=4096
CONFIG_COMMON_LIBC_MALLOC_ARENA_SIZE=12288

# enable power management
CONFIG_PM=y

# SED device with its poll interval
CONFIG_OPENTHREAD_MTD=y
CONFIG_OPENTHREAD_MTD_SED=y
CONFIG_OPENTHREAD_POLL_PERIOD=1000

# sync matter light-switch configurations
CONFIG_OPENTHREAD_SLAAC=y
CONFIG_OPENTHREAD_DNS_CLIENT=y
CONFIG_OPENTHREAD_ECDSA=y
CONFIG_OPENTHREAD_SRP_CLIENT=y
CONFIG_OPENTHREAD_DEFAULT_TX_POWER=3

# thread network credentials
CONFIG_OPENTHREAD_CHANNEL=14
CONFIG_OPENTHREAD_PANID=1419
CONFIG_OPENTHREAD_XPANID="11:11:11:11:22:22:44:44"
CONFIG_OPENTHREAD_NETWORKKEY="ff:ee:dd:cc:bb:aa:99:88:77:66:55:44:33:22:11:00"

# Use NVS as settings backend
CONFIG_NVS=y

# BLE && Thread coexistence
CONFIG_IEEE802154_TLX_BLE_COEXIST=y
CONFIG_DYNAMIC_INTERRUPTS=y
CONFIG_OPENTHREAD_MANUAL_START=y

CONFIG_BT=y
CONFIG_LOG=y
CONFIG_BT_SMP=y
CONFIG_BT_PERIPHERAL=y
CONFIG_BT_DIS=y
CONFIG_BT_DIS_PNP=n
CONFIG_BT_DEVICE_NAME="Zephyr concurrent PM"
CONFIG_BT_DEVICE_APPEARANCE=768
```

## boards/tl3238x.conf
```kconfig
# usb
CONFIG_USB_DEVICE_STACK=n
CONFIG_USB_DEVICE_INITIALIZE_AT_BOOT=n

# Telink relative thread features
CONFIG_NET_PKT_TXTIME=y
CONFIG_NET_PKT_TIMESTAMP=y
CONFIG_IEEE802154_TLX_MAC_FLASH=y
```

## boards/tl3238x_retention.conf
```kconfig
# usb
CONFIG_USB_DEVICE_STACK=n
CONFIG_USB_DEVICE_INITIALIZE_AT_BOOT=n

# Telink relative thread features
CONFIG_NET_PKT_TXTIME=y
CONFIG_NET_PKT_TIMESTAMP=y
CONFIG_IEEE802154_TLX_MAC_FLASH=y

CONFIG_IEEE802154_TLX_OPTIMIZATION=y
```

## boards/tl7218x.conf
```kconfig
# usb
CONFIG_USB_DEVICE_STACK=n
CONFIG_USB_DEVICE_INITIALIZE_AT_BOOT=n

# Telink relative thread features
CONFIG_NET_PKT_TXTIME=y
CONFIG_NET_PKT_TIMESTAMP=y
CONFIG_IEEE802154_TLX_MAC_FLASH=y

# CONFIG_OPENTHREAD_JOINER=n
# CONFIG_OPENTHREAD_COMMISSIONER=n
# CONFIG_OPENTHREAD_COAP=n
# CONFIG_OPENTHREAD_COAPS=n
# CONFIG_OPENTHREAD_TCP_ENABLE=n
# CONFIG_OPENTHREAD_DNS_CLIENT_OVER_TCP=n
```

## boards/tl7218x_retention.conf
```kconfig
# usb
CONFIG_USB_DEVICE_STACK=n
CONFIG_USB_DEVICE_INITIALIZE_AT_BOOT=n

# Telink relative thread features
CONFIG_NET_PKT_TXTIME=y
CONFIG_NET_PKT_TIMESTAMP=y
CONFIG_IEEE802154_TLX_MAC_FLASH=y

CONFIG_IEEE802154_TLX_OPTIMIZATION=y

# CONFIG_OPENTHREAD_JOINER=n
# CONFIG_OPENTHREAD_COMMISSIONER=n
# CONFIG_OPENTHREAD_COAP=n
# CONFIG_OPENTHREAD_COAPS=n
# CONFIG_OPENTHREAD_TCP_ENABLE=n
# CONFIG_OPENTHREAD_DNS_CLIENT_OVER_TCP=n
```

## src/main.c
```c
/* main.c - OpenThread */

/*
 * Copyright (c) 2023-2026 Telink
 *
 * SPDX-License-Identifier: Apache-2.0
 */

#include <zephyr/kernel.h>
#include <zephyr/devicetree.h>
#include <zephyr/logging/log.h>
LOG_MODULE_REGISTER(ot_main, LOG_LEVEL_DBG);

#include <zephyr/net/openthread.h>
#include <openthread/thread.h>
#include <zephyr/bluetooth/bluetooth.h>
#include <zephyr/settings/settings.h>

#include "tlx_bt_init.h"
#include "thd_task.h"

#ifdef CONFIG_IEEE802154_TLX_BLE_COEXIST

static struct k_work_delayable post_join_dwork;
static struct k_work_delayable ble_enable_dwork;

extern volatile bool tlx_rf_802154_mode;

volatile bool isThreadCommissioned;

/* BLE control state */
enum ble_ctrl_state {
	BLE_STATE_COEXIST, /* default after boot: Thread + BLE time-share RF */
	BLE_STATE_OFF,     /* BLE off: 802.15.4 owns RF exclusively */
	BLE_STATE_BUSY,    /* switching, prevent re-entry */
};

static enum ble_ctrl_state ble_state = BLE_STATE_COEXIST;

/* Disable BLE: hand RF over to 802.15.4 (the original dual_mode_suspend logic) */
static void ble_disable(void)
{
	tlx_bt_802154_dual_mode_disable();

	/* Wait for RF to park back to BLE mode (timeout 1000 ms) */
	for (uint32_t waited_ms = 0; tlx_rf_802154_mode; waited_ms += 10) {
		if (waited_ms >= 1000) {
			LOG_ERR("RF failed to park in BLE mode, skip BLE teardown");
			ble_state = BLE_STATE_COEXIST;
			return;
		}
		k_sleep(K_MSEC(10));
	}

	bt_le_adv_stop();

	if (bt_disable()) {
		LOG_ERR("bt_disable failed, continue with 802.15.4 revival");
	}

	tlx_bt_802154_dual_mode_suspend();

	ble_state = BLE_STATE_OFF;
	LOG_INF("BLE off: RF owned by 802.15.4");

	/* Test: auto re-enable BLE after 5s to verify coexistence restore */
	k_work_schedule(&ble_enable_dwork, K_SECONDS(5));
}

extern void bt_le_adv_restart(void);

/* Enable BLE: restore Thread + BLE coexistence */
static void ble_enable(void)
{
	/* 1. Revert 802.15.4 ownership and park back to BLE mode */
	tlx_bt_802154_dual_mode_resume();

	/* 2. Re-init BLE host+controller:
	 *    hci_tlx_open -> tlx_bt_controller_init()
	 *      -> rf_radio_reset() + rf_drv_ble_init()   (RF back to BLE)
	 *      -> tlx_bt_802154_dual_mode_enable()       (re-register mode-change/ISR callbacks)
	 *      -> tlx_bt_irq_init()                      (reconnect IRQ_ZB_RT to rf_irq_handler)
	 */
	int err = bt_enable(NULL);

	if (err) {
		LOG_ERR("bt_enable failed (%d), rollback to 802.15.4", err);
		tlx_bt_802154_dual_mode_suspend();
		ble_state = BLE_STATE_OFF;
		return;
	}

	/* Reload bonded keys (bt_disable() clears them via bt_keys_reset) */
	if (IS_ENABLED(CONFIG_SETTINGS)) {
		settings_load();
	}

	/* 3. Restart advertising */
	bt_le_adv_restart();

	/* Same as the boot-time bt_le_task_init(): give the BLE controller thread a
	 * window to run (broadcast / connection / connection parameter update) before
	 * the Thread insert task starts switching the RF. k_sleep() lets the BLE
	 * thread run, unlike k_busy_wait() which would keep it starved.
	 */
	/* k_sleep(K_SECONDS(1)); */

	/* 4. Restore insert-task time-sharing: 802.15.4 runs in the BLE scheduler again.
	 *    The switch_to_802154_mode() callback then resumes OT threads + gives ready_sem
	 */
	tlksdk_thd_enableInsertTask1(0x01);

	ble_state = BLE_STATE_COEXIST;
	LOG_INF("BLE on: Thread + BLE coexist");
}

/* Public interface: enable/disable BLE by parameter */
void ble_ctrl_set(bool enable)
{
	bool is_on = (ble_state == BLE_STATE_COEXIST);

	if (enable == is_on || ble_state == BLE_STATE_BUSY) {
		return;
	}

	ble_state = BLE_STATE_BUSY;

	if (enable) {
		ble_enable();
	} else {
		ble_disable();
	}
}

/* Test: auto call ble_enable 5s after ble_disable to verify coexistence restore */
static void ble_enable_dwork_handler(struct k_work *work)
{
	LOG_INF("Test: re-enable BLE to verify coexistence restore");
	ble_ctrl_set(true);
}

static void post_join_dwork_handler(struct k_work *work)
{
	otDeviceRole role = otThreadGetDeviceRole(openthread_get_default_context()->instance);

	/* Re-check still attached (child) after delay, avoid stopping BLE while detached */
	if (role != OT_DEVICE_ROLE_CHILD) {
		LOG_INF("Not in Thread network anymore, skip post-join");
		return;
	}

	LOG_INF("Thread joined: stop BLE entirely, handover RF to 802.15.4");

	ble_ctrl_set(false);
}
#endif /* CONFIG_IEEE802154_TLX_BLE_COEXIST */

static void ot_show_ip6_addr(otInstance *inst)
{
	const otNetifAddress *ip6_addr = otIp6GetUnicastAddresses(inst);

	for (const otNetifAddress *addr = ip6_addr; addr; addr = addr->mNext) {
		if (addr->mValid) {
			char ip6_str[OT_IP6_ADDRESS_STRING_SIZE];

			otIp6AddressToString(&addr->mAddress, ip6_str, sizeof(ip6_str));
			LOG_INF("ip: %s", ip6_str);
		}
	}
}

static void ot_satate_changed(otChangedFlags flags, struct openthread_context *ot_context,
			      void *user_data)
{
	if (flags & OT_CHANGED_THREAD_ROLE) {
		otDeviceRole role = otThreadGetDeviceRole(ot_context->instance);

		/* Joined as child/router, run once: schedule stopping insert task + BLE adv after a
		 * delay
		 */
		if (role == OT_DEVICE_ROLE_CHILD) {
#ifdef CONFIG_IEEE802154_TLX_BLE_COEXIST
			LOG_INF("Thread joined: schedule post-join & stop adv in 30s");
			k_work_schedule(&post_join_dwork, K_SECONDS(5));
			isThreadCommissioned = true;
#endif
		}

		switch (role) {
		case OT_DEVICE_ROLE_CHILD:
			LOG_INF("OT child");
			LOG_INF("OT Short address: %04x",
				otLinkGetShortAddress(ot_context->instance));
			LOG_HEXDUMP_INF(otLinkGetExtendedAddress(ot_context->instance),
					OT_EXT_ADDRESS_SIZE, "OT Extended address:");
			ot_show_ip6_addr(ot_context->instance);
			break;
		case OT_DEVICE_ROLE_ROUTER:
			LOG_INF("OT router");
			LOG_INF("OT Short address: %04x",
				otLinkGetShortAddress(ot_context->instance));
			LOG_HEXDUMP_INF(otLinkGetExtendedAddress(ot_context->instance),
					OT_EXT_ADDRESS_SIZE, "OT Extended address:");
			ot_show_ip6_addr(ot_context->instance);
			break;
		case OT_DEVICE_ROLE_LEADER:
			LOG_INF("OT leader");
			LOG_INF("OT Short address: %04x",
				otLinkGetShortAddress(ot_context->instance));
			LOG_HEXDUMP_INF(otLinkGetExtendedAddress(ot_context->instance),
					OT_EXT_ADDRESS_SIZE, "OT Extended address:");
			ot_show_ip6_addr(ot_context->instance);
			break;
		case OT_DEVICE_ROLE_DISABLED:
			LOG_INF("OT disabled");
			break;
		case OT_DEVICE_ROLE_DETACHED:
			LOG_INF("OT detached");
			break;
		default:
			LOG_INF("OT unknown");
			break;
		}
	}
}

int main(void)
{
	LOG_INF("***** OpenThread + BLE Peripheral *****");

	static struct openthread_state_changed_cb ot_state_cahnge = {.state_changed_cb =
									     ot_satate_changed};

	openthread_state_changed_cb_register(openthread_get_default_context(), &ot_state_cahnge);

#ifdef CONFIG_IEEE802154_TLX_BLE_COEXIST
	k_work_init_delayable(&post_join_dwork, post_join_dwork_handler);
	k_work_init_delayable(&ble_enable_dwork, ble_enable_dwork_handler);

	extern void bt_le_task_init(void);
	bt_le_task_init();
#endif

	return 0;
}
```

## src/cs_reflector.c
```c
/*
 * Channel Sounding RAS Reflector port for ot_ble_test.
 * Adapted from samples/bluetooth/channel_sounding/connected_cs/reflector.
 *
 * Copyright (c) 2024 Nordic Semiconductor ASA
 * Copyright (c) 2025 Telink Semiconductor
 * SPDX-License-Identifier: Apache-2.0
 */

#include <zephyr/sys/byteorder.h>
#include <zephyr/bluetooth/bluetooth.h>
#include <zephyr/bluetooth/cs.h>
#include <zephyr/bluetooth/gatt.h>
#include <zephyr/bluetooth/uuid.h>
#include <zephyr/bluetooth/conn.h>
#include <zephyr/settings/settings.h>

#include <zephyr/logging/log.h>
LOG_MODULE_REGISTER(ot_ble_cs, LOG_LEVEL_INF);

#define RAS_DBG 0

#if RAS_DBG
#define RAS_PRINTK(...) printk(__VA_ARGS__)
#else
#define RAS_PRINTK(...)
#endif

/* RAS Service UUIDs */
#define BT_UUID_RAS_SERVICE_VAL          0x185B
#define BT_UUID_RAS_FEATURE_VAL          0x2C14
#define BT_UUID_RAS_REAL_TIME_DATA_VAL   0x2C15
#define BT_UUID_RAS_ON_DEMAND_DATA_VAL   0x2C16
#define BT_UUID_RAS_CONTROL_POINT_VAL    0x2C17
#define BT_UUID_RAS_DATA_READY_VAL       0x2C18
#define BT_UUID_RAS_DATA_OVERWRITTEN_VAL 0x2C19

#define BT_UUID_RAS_SERVICE          BT_UUID_DECLARE_16(BT_UUID_RAS_SERVICE_VAL)
#define BT_UUID_RAS_FEATURE          BT_UUID_DECLARE_16(BT_UUID_RAS_FEATURE_VAL)
#define BT_UUID_RAS_REAL_TIME_DATA   BT_UUID_DECLARE_16(BT_UUID_RAS_REAL_TIME_DATA_VAL)
#define BT_UUID_RAS_ON_DEMAND_DATA   BT_UUID_DECLARE_16(BT_UUID_RAS_ON_DEMAND_DATA_VAL)
#define BT_UUID_RAS_CONTROL_POINT    BT_UUID_DECLARE_16(BT_UUID_RAS_CONTROL_POINT_VAL)
#define BT_UUID_RAS_DATA_READY       BT_UUID_DECLARE_16(BT_UUID_RAS_DATA_READY_VAL)
#define BT_UUID_RAS_DATA_OVERWRITTEN BT_UUID_DECLARE_16(BT_UUID_RAS_DATA_OVERWRITTEN_VAL)

/* RAS State */
enum {
	RAS_IDX_SVC,
	RAS_IDX_FEATURE_CHAR,
	RAS_IDX_FEATURE_VAL,
	RAS_IDX_RT_DATA_CHAR,
	RAS_IDX_RT_DATA_VAL,
	RAS_IDX_RT_DATA_CCC,
	RAS_IDX_OD_DATA_CHAR,
	RAS_IDX_OD_DATA_VAL,
	RAS_IDX_OD_DATA_CCC,
	RAS_IDX_CP_CHAR,
	RAS_IDX_CP_VAL,
	RAS_IDX_CP_CCC,
	RAS_IDX_DR_CHAR,
	RAS_IDX_DR_VAL,
	RAS_IDX_DR_CCC,
	RAS_IDX_DO_CHAR,
	RAS_IDX_DO_VAL,
	RAS_IDX_DO_CCC,
	RAS_IDX_MAX,
};

/* RAS feature bitmask (Core Spec v6.0 Vol 3B 7.3) */
static uint8_t ras_feature = (1 << 0) | /* realTimeProcedureDataSupport */
			     (1 << 1) | /* getLostProcedureDataSegmentsSupport */
			     (1 << 2);  /* abortOperationSupport */

/* CCC enable flags */
static uint16_t ras_realtime_ccc;
static uint16_t ras_ondemand_ccc;
static uint16_t ras_controlpoint_ccc;
static uint16_t ras_dataready_ccc;
static uint16_t ras_dataoverwritten_ccc;

/* Latest procedure counter */
static uint16_t latest_procedure_counter;

/* CS config */
#define CS_CONFIG_ID     0
#define NUM_MODE_0_STEPS 1

/* Connection */
static struct bt_conn *connection;

/* RAS Ranging Data structures */

#define RAS_RANGING_HEADER_LEN  4
#define RAS_SUBEVENT_HEADER_LEN 8
#define RAS_SEG_HEADER_LEN      1

#define RAS_PROCEDURE_MAX_SIZE 1000

#define RAS_PROCEDURE_SLOTS 1

struct ras_procedure_slot {
	uint8_t data[RAS_PROCEDURE_MAX_SIZE];
	uint16_t len;
	uint16_t procedure_counter;
	uint8_t config_id;
	bool in_use;
};

static struct ras_procedure_slot ras_proc_slots[RAS_PROCEDURE_SLOTS];
static int ras_current_slot;
static uint16_t ras_current_procedure_counter;
static bool ras_first_subevent;

static int8_t ras_selected_tx_power;
static uint8_t ras_seg_counter;

/* Forward declaration - ras_attrs used by subevent_result_cb and GATT callbacks */
static struct bt_gatt_attr ras_attrs[];

/* RAS helper: build segmentation header */
static uint8_t ras_build_seg_header(bool first_seg, bool last_seg, uint8_t seg_idx)
{
	uint8_t hdr = 0;

	if (first_seg) {
		hdr |= (1 << 0);
	}
	if (last_seg) {
		hdr |= (1 << 1);
	}
	hdr |= ((seg_idx & 0x3F) << 2);
	return hdr;
}

/* RAS helper: build Ranging Header */
static void ras_build_ranging_header(uint8_t *buf, uint16_t procedure_counter, uint8_t config_id,
				     int8_t tx_power, uint8_t num_antenna_paths)
{
	uint16_t word0 = (procedure_counter & 0x0FFF) | ((config_id & 0x0F) << 12);

	buf[0] = (uint8_t)(word0 >> 0);
	buf[1] = (uint8_t)(word0 >> 8);
	buf[2] = (uint8_t)tx_power;

	buf[3] = 0;
	for (uint8_t i = 0; i < num_antenna_paths && i < 4; i++) {
		buf[3] |= (1 << i);
	}
}

/* RAS helper: build Subevent Header */
static void ras_build_subevent_header(uint8_t *buf, struct bt_conn_le_cs_subevent_result *result)
{
	buf[0] = (result->header.start_acl_conn_event >> 0) & 0xFF;
	buf[1] = (result->header.start_acl_conn_event >> 8) & 0xFF;

	buf[2] = (result->header.frequency_compensation >> 0) & 0xFF;
	buf[3] = (result->header.frequency_compensation >> 8) & 0xFF;

	buf[4] = ((result->header.procedure_done_status & 0x0F) << 0) |
		 ((result->header.subevent_done_status & 0x0F) << 4);

	buf[5] = ((result->header.procedure_abort_reason & 0x0F) << 0) |
		 ((result->header.subevent_abort_reason & 0x0F) << 4);

	buf[6] = (uint8_t)result->header.reference_power_level;

	buf[7] = result->header.num_steps_reported;
}

/* RAS helper: convert HCI step data to RAS Subevent Data */
static uint16_t ras_convert_step_data(uint8_t *buf, struct bt_conn_le_cs_subevent_result *result)
{
	struct net_buf_simple *sbuf = result->step_data_buf;
	uint8_t num_steps = result->header.num_steps_reported;
	bool subevent_aborted =
		(result->header.subevent_done_status == BT_CONN_LE_CS_SUBEVENT_ABORTED);
	uint8_t abort_step = result->header.abort_step;
	uint8_t *wptr = buf;
	uint16_t offset = 0;

	if (!sbuf || sbuf->len == 0 || num_steps == 0) {
		return 0;
	}

	for (uint8_t i = 0; i < num_steps; i++) {
		bool step_aborted = subevent_aborted && (i >= abort_step);

		if (offset + 3 > sbuf->len) {
			*wptr++ = 0x80;
			break;
		}

		uint8_t step_mode = sbuf->data[offset];
		uint8_t step_data_len = sbuf->data[offset + 2];

		*wptr++ = (step_mode & 0x03) | (step_aborted ? 0x80 : 0x00);

		offset += 3;

		if (!step_aborted && step_data_len > 0) {
			if (offset + step_data_len <= sbuf->len) {
				memcpy(wptr, &sbuf->data[offset], step_data_len);
				wptr += step_data_len;
			}
			offset += step_data_len;
		} else if (step_data_len > 0) {
			offset += step_data_len;
		}
	}

	return (uint16_t)(wptr - buf);
}

static uint16_t ras_build_subevent_data(uint8_t *buf, struct bt_conn_le_cs_subevent_result *result,
					bool is_first)
{
	uint8_t *wptr = buf;

	if (is_first) {
		ras_build_ranging_header(wptr, result->header.procedure_counter,
					 result->header.config_id, ras_selected_tx_power,
					 result->header.num_antenna_paths);
		wptr += RAS_RANGING_HEADER_LEN;
	}

	ras_build_subevent_header(wptr, result);
	wptr += RAS_SUBEVENT_HEADER_LEN;

	if (result->step_data_buf && result->step_data_buf->len > 0) {
		wptr += ras_convert_step_data(wptr, result);
	}

	return (uint16_t)(wptr - buf);
}

/* RAS data sending with work queue */
#define MAX_RAS_DATA_SIZE  1000
#define RAS_CHUNK_BUF_SIZE 248

static uint8_t ras_work_buf[MAX_RAS_DATA_SIZE];
static uint16_t ras_work_len;
static const struct bt_gatt_attr *ras_work_attr;
static struct bt_conn *ras_work_conn;
static bool ras_work_is_first;
static bool ras_work_is_last;
static uint8_t ras_work_seg_start;
static volatile bool ras_sending;

static struct k_work ras_send_work;
static uint8_t ras_chunk_buf[RAS_CHUNK_BUF_SIZE];

static void ras_send_work_handler(struct k_work *work)
{
	uint16_t mtu = bt_gatt_get_mtu(ras_work_conn);
	uint16_t max_payload = (mtu > 3) ? (mtu - 3) : 20;
	uint16_t offset = 0;
	uint8_t seg_idx = ras_work_seg_start;

	max_payload -= RAS_SEG_HEADER_LEN;

	while (offset < ras_work_len) {
		uint16_t remaining = ras_work_len - offset;
		uint16_t chunk_len = MIN(remaining, max_payload);
		bool first_seg = (ras_work_is_first && offset == 0);
		bool last_seg = (ras_work_is_last && offset + chunk_len >= ras_work_len);
		uint8_t seg_hdr = ras_build_seg_header(first_seg, last_seg, seg_idx);
		int err;

		ras_chunk_buf[0] = seg_hdr;
		memcpy(&ras_chunk_buf[1], &ras_work_buf[offset], chunk_len);

		err = bt_gatt_notify(ras_work_conn, ras_work_attr, ras_chunk_buf, 1 + chunk_len);
		if (err) {
			RAS_PRINTK("RAS: chunk fail err=%d seg=%u\n", err, seg_idx);
			break;
		}

		RAS_PRINTK("RAS: chunk ok seg=%u first=%d last=%d off=%u len=%u\n", seg_idx,
			   first_seg, last_seg, offset, chunk_len);

		offset += chunk_len;
		seg_idx = (seg_idx + 1) & 0x3F;
	}

	ras_seg_counter = seg_idx;
	RAS_PRINTK("RAS: send done, total=%u seg_counter=%u\n", ras_work_len, ras_seg_counter);

	bt_conn_unref(ras_work_conn);
	ras_work_conn = NULL;
	ras_sending = false;
}

static void ras_notify_with_frag(struct bt_conn *conn, const struct bt_gatt_attr *attr,
				 const void *data, uint16_t len, bool is_proc_first,
				 bool is_proc_last)
{
	if (ras_sending) {
		RAS_PRINTK("RAS: send busy, dropping data\n");
		return;
	}

	if (len > MAX_RAS_DATA_SIZE) {
		RAS_PRINTK("RAS: data too large %u > %u, truncating\n", len, MAX_RAS_DATA_SIZE);
		len = MAX_RAS_DATA_SIZE;
	}

	memcpy(ras_work_buf, data, len);
	ras_work_len = len;
	ras_work_attr = attr;
	ras_work_conn = bt_conn_ref(conn);
	ras_work_is_first = is_proc_first;
	ras_work_is_last = is_proc_last;
	ras_work_seg_start = ras_seg_counter;
	ras_sending = true;

	RAS_PRINTK("RAS: submit work %u bytes first=%d last=%d\n", len, is_proc_first,
		   is_proc_last);

	k_work_submit(&ras_send_work);
}

/* CS subevent result */
static uint8_t ras_subevent_buf[1000];

static void subevent_result_cb(struct bt_conn *conn, struct bt_conn_le_cs_subevent_result *result)
{
	uint16_t proc_counter = result->header.procedure_counter;
	uint16_t subevent_len;
	bool is_first;

	RAS_PRINTK("RAS: subevent proc=%u cfg=%u steps=%u AP=%u done=%u\n", proc_counter,
		   result->header.config_id, result->header.num_steps_reported,
		   result->header.num_antenna_paths, result->header.procedure_done_status);

	if (!ras_first_subevent || proc_counter != ras_current_procedure_counter) {
		ras_current_procedure_counter = proc_counter;
		ras_first_subevent = true;
		ras_seg_counter = 0;

		ras_current_slot = -1;
		for (int i = 0; i < RAS_PROCEDURE_SLOTS; i++) {
			if (!ras_proc_slots[i].in_use) {
				ras_current_slot = i;
				break;
			}
		}
		if (ras_current_slot < 0) {
			ras_current_slot = 0;
			RAS_PRINTK("RAS: overwriting oldest slot\n");
		}

		ras_proc_slots[ras_current_slot].in_use = true;
		ras_proc_slots[ras_current_slot].len = 0;
		ras_proc_slots[ras_current_slot].procedure_counter = proc_counter;
		ras_proc_slots[ras_current_slot].config_id = result->header.config_id;

		RAS_PRINTK("RAS: new procedure %u, slot %d\n", proc_counter, ras_current_slot);
	}

	is_first = ras_first_subevent;
	ras_first_subevent = false;

	subevent_len = ras_build_subevent_data(ras_subevent_buf, result, is_first);

	if (ras_current_slot >= 0) {
		struct ras_procedure_slot *slot = &ras_proc_slots[ras_current_slot];
		uint16_t new_len = slot->len + subevent_len;

		if (new_len <= RAS_PROCEDURE_MAX_SIZE) {
			memcpy(&slot->data[slot->len], ras_subevent_buf, subevent_len);
			slot->len = new_len;
		} else {
			RAS_PRINTK("RAS: slot %d overflow, dropping subevent\n", ras_current_slot);
		}
	}

	if (ras_realtime_ccc & BT_GATT_CCC_NOTIFY) {
		bool is_proc_last =
			(result->header.procedure_done_status == BT_CONN_LE_CS_PROCEDURE_COMPLETE);

		ras_notify_with_frag(conn, &ras_attrs[RAS_IDX_RT_DATA_VAL], ras_subevent_buf,
				     subevent_len, is_first, is_proc_last);
	}

	latest_procedure_counter = proc_counter;

	if (result->header.procedure_done_status == BT_CONN_LE_CS_PROCEDURE_COMPLETE) {
		RAS_PRINTK("RAS: procedure %u complete, %u bytes in slot %d\n", proc_counter,
			   ras_proc_slots[ras_current_slot].len, ras_current_slot);

		if (ras_dataready_ccc & BT_GATT_CCC_NOTIFY) {
			uint8_t dr_data[2];

			sys_put_le16(latest_procedure_counter & 0x0FFF, dr_data);
			bt_gatt_notify(conn, &ras_attrs[RAS_IDX_DR_VAL], dr_data, sizeof(dr_data));
			RAS_PRINTK("RAS: notified Data Ready procedure=%u\n",
				   latest_procedure_counter);
		}
	}
}

/* RAS GATT callbacks */
static ssize_t ras_gatt_read(struct bt_conn *conn, const struct bt_gatt_attr *attr, void *buf,
			     uint16_t len, uint16_t offset)
{
	if (attr == &ras_attrs[RAS_IDX_FEATURE_VAL]) {
		return bt_gatt_attr_read(conn, attr, buf, len, offset, &ras_feature,
					 sizeof(ras_feature));
	}
	RAS_PRINTK("RAS GATT read: handle 0x%x len=%u offset=%u\n", attr->handle, len, offset);
	return 0;
}

static void ras_gatt_ccc_cfg_changed(const struct bt_gatt_attr *attr, uint16_t value)
{
	RAS_PRINTK("RAS CCC changed: handle 0x%x val=0x%04x\n", attr->handle, value);

	if (attr == &ras_attrs[RAS_IDX_RT_DATA_CCC]) {
		ras_realtime_ccc = value;
	} else if (attr == &ras_attrs[RAS_IDX_OD_DATA_CCC]) {
		ras_ondemand_ccc = value;
	} else if (attr == &ras_attrs[RAS_IDX_CP_CCC]) {
		ras_controlpoint_ccc = value;
	} else if (attr == &ras_attrs[RAS_IDX_DR_CCC]) {
		ras_dataready_ccc = value;
	} else if (attr == &ras_attrs[RAS_IDX_DO_CCC]) {
		ras_dataoverwritten_ccc = value;
	}
}

static ssize_t ras_gatt_cp_write(struct bt_conn *conn, const struct bt_gatt_attr *attr,
				 const void *buf, uint16_t len, uint16_t offset, uint8_t flags)
{
	const uint8_t *data = buf;
	uint8_t opcode = data[0];
	static uint8_t cp_rsp[3];

	RAS_PRINTK("RAS Control Point: opcode=0x%02x len=%u\n", opcode, len);

	switch (opcode) {
	case 0x01:
		RAS_PRINTK("  => Set RAS Configuration\n");
		break;
	case 0x02:
		RAS_PRINTK("  => RAS Control Point Command\n");
		break;
	case 0x03:
		RAS_PRINTK("  => Get Procedure Data\n");
		break;
	case 0x04:
		RAS_PRINTK("  => Abort RAS Procedure\n");
		break;
	default:
		RAS_PRINTK("  => Unknown opcode\n");
		break;
	}

	if (ras_controlpoint_ccc & BT_GATT_CCC_INDICATE) {
		static struct bt_gatt_indicate_params ind_params;

		cp_rsp[0] = opcode;
		cp_rsp[1] = 0x00; /* success */
		cp_rsp[2] = 0x00;

		ind_params.attr = (struct bt_gatt_attr *)attr;
		ind_params.data = cp_rsp;
		ind_params.len = sizeof(cp_rsp);
		ind_params.func = NULL;
		ind_params.destroy = NULL;

		bt_gatt_indicate(conn, &ind_params);
		RAS_PRINTK("  => Indication sent\n");
	}
	return len;
}

/* RAS GATT service (Zephyr native) */
static struct bt_gatt_attr ras_attrs[] = {
	BT_GATT_PRIMARY_SERVICE(BT_UUID_RAS_SERVICE),

	BT_GATT_CHARACTERISTIC(BT_UUID_RAS_FEATURE, BT_GATT_CHRC_READ, BT_GATT_PERM_READ,
			       ras_gatt_read, NULL, NULL),

	BT_GATT_CHARACTERISTIC(BT_UUID_RAS_REAL_TIME_DATA, BT_GATT_CHRC_READ | BT_GATT_CHRC_NOTIFY,
			       BT_GATT_PERM_READ, ras_gatt_read, NULL, NULL),
	BT_GATT_CCC(ras_gatt_ccc_cfg_changed, BT_GATT_PERM_READ | BT_GATT_PERM_WRITE),

	BT_GATT_CHARACTERISTIC(BT_UUID_RAS_ON_DEMAND_DATA, BT_GATT_CHRC_READ | BT_GATT_CHRC_NOTIFY,
			       BT_GATT_PERM_READ, ras_gatt_read, NULL, NULL),
	BT_GATT_CCC(ras_gatt_ccc_cfg_changed, BT_GATT_PERM_READ | BT_GATT_PERM_WRITE),

	BT_GATT_CHARACTERISTIC(BT_UUID_RAS_CONTROL_POINT,
			       BT_GATT_CHRC_WRITE | BT_GATT_CHRC_INDICATE, BT_GATT_PERM_WRITE, NULL,
			       ras_gatt_cp_write, NULL),
	BT_GATT_CCC(ras_gatt_ccc_cfg_changed, BT_GATT_PERM_READ | BT_GATT_PERM_WRITE),

	BT_GATT_CHARACTERISTIC(BT_UUID_RAS_DATA_READY, BT_GATT_CHRC_READ | BT_GATT_CHRC_NOTIFY,
			       BT_GATT_PERM_READ, ras_gatt_read, NULL, NULL),
	BT_GATT_CCC(ras_gatt_ccc_cfg_changed, BT_GATT_PERM_READ | BT_GATT_PERM_WRITE),

	BT_GATT_CHARACTERISTIC(BT_UUID_RAS_DATA_OVERWRITTEN, BT_GATT_CHRC_NOTIFY, BT_GATT_PERM_NONE,
			       NULL, NULL, NULL),
	BT_GATT_CCC(ras_gatt_ccc_cfg_changed, BT_GATT_PERM_READ | BT_GATT_PERM_WRITE),
};

static struct bt_gatt_service ras_service = BT_GATT_SERVICE(ras_attrs);

/* MTU exchange */
static void mtu_exchange_cb(struct bt_conn *conn, uint8_t err,
			    struct bt_gatt_exchange_params *params)
{
	printk("MTU exchange %s (%u)\n", err == 0U ? "success" : "failed", bt_gatt_get_mtu(conn));
}

static void mtu_updated(struct bt_conn *conn, uint16_t tx, uint16_t rx)
{
	printk("MTU updated: TX=%u RX=%u\n", tx, rx);
}

static struct bt_gatt_cb gatt_callbacks = {
	.att_mtu_updated = mtu_updated,
};

/* CS default settings work */
static void cs_set_default_settings_work_handler(struct k_work *work)
{
	const struct bt_le_cs_set_default_settings_param default_settings = {
		.enable_initiator_role = false,
		.enable_reflector_role = true,
		.cs_sync_antenna_selection = BT_LE_CS_ANTENNA_SELECTION_OPT_REPETITIVE,
		.max_tx_power = BT_HCI_OP_LE_CS_MAX_MAX_TX_POWER,
	};
	int err;

	if (!connection) {
		printk("CS: no connection, skip default settings\n");
		return;
	}

	err = bt_le_cs_set_default_settings(connection, &default_settings);
	if (err) {
		printk("Failed to configure default CS settings (err %d)\n", err);
	} else {
		printk("CS default settings configured (reflector role)\n");
	}
}

static struct k_work cs_set_default_settings_work;

/* CS callbacks */
static void remote_capabilities_cb(struct bt_conn *conn, struct bt_conn_le_cs_capabilities *params)
{
	ARG_UNUSED(params);
	printk("CS capability exchange completed.\n");
}

static void config_created_cb(struct bt_conn *conn, struct bt_conn_le_cs_config *config)
{
	printk("CS config creation complete. ID: %d\n", config->id);
}

static void security_enabled_cb(struct bt_conn *conn)
{
	printk("CS security enabled.\n");
	k_work_submit(&cs_set_default_settings_work);
}

static void procedure_enabled_cb(struct bt_conn *conn,
				 struct bt_conn_le_cs_procedure_enable_complete *params)
{
	printk("CS procedures %s, selected_tx_power=%d dBm\n",
	       params->state ? "enabled" : "disabled", params->selected_tx_power);

	if (params->selected_tx_power != 0x7F) {
		ras_selected_tx_power = params->selected_tx_power;
	} else {
		ras_selected_tx_power = 0;
	}
}

static void security_changed_cb(struct bt_conn *conn, bt_security_t level, enum bt_security_err err)
{
	if (err) {
		printk("Security failed: level %u err %d\n", level, err);
		return;
	}
	printk("Security changed: level %u\n", level);
}

static void pairing_complete_cb(struct bt_conn *conn, bool bonded)
{
	printk("Pairing complete: %s\n", bonded ? "bonded" : "not bonded");
}

static void pairing_failed_cb(struct bt_conn *conn, enum bt_security_err reason)
{
	printk("Pairing failed: reason %d\n", reason);
}

static struct bt_conn_auth_info_cb conn_auth_info_callbacks = {
	.pairing_complete = pairing_complete_cb,
	.pairing_failed = pairing_failed_cb,
};

BT_CONN_CB_DEFINE(conn_cs_callbacks) = {
	.security_changed = security_changed_cb,
	.le_cs_remote_capabilities_available = remote_capabilities_cb,
	.le_cs_config_created = config_created_cb,
	.le_cs_security_enabled = security_enabled_cb,
	.le_cs_procedure_enabled = procedure_enabled_cb,
	.le_cs_subevent_data_available = subevent_result_cb,
};

/* Public API */
void cs_reflector_init(void)
{
	int err;

	RAS_PRINTK("CS RAS Reflector init\n");

	k_work_init(&ras_send_work, ras_send_work_handler);
	k_work_init(&cs_set_default_settings_work, cs_set_default_settings_work_handler);

	bt_conn_auth_info_cb_register(&conn_auth_info_callbacks);
	bt_gatt_cb_register(&gatt_callbacks);

	err = bt_gatt_service_register(&ras_service);
	if (err) {
		printk("RAS service register failed (err %d)\n", err);
		return;
	}
	RAS_PRINTK("RAS service registered\n");
}

void cs_reflector_on_connected(struct bt_conn *conn, uint8_t err)
{
	int sec_err;

	if (err) {
		return;
	}

	if (connection) {
		bt_conn_unref(connection);
		connection = NULL;
	}

	connection = bt_conn_ref(conn);

	static struct bt_gatt_exchange_params mtu_exchange_params;

	mtu_exchange_params.func = mtu_exchange_cb;
	err = bt_gatt_exchange_mtu(connection, &mtu_exchange_params);
	if (err) {
		printk("MTU exchange failed (err %d)\n", err);
	}

	sec_err = bt_conn_set_security(connection, BT_SECURITY_L2);
	if (sec_err) {
		printk("Failed to request security (err %d)\n", sec_err);
	}
}

void cs_reflector_on_disconnected(struct bt_conn *conn)
{
	if (connection) {
		bt_conn_unref(connection);
		connection = NULL;
	}
	ras_first_subevent = false;
	ras_sending = false;
}
```

## src/le_task.c
```c
/*
 * Copyright (c) 2023-2026 Telink
 *
 * SPDX-License-Identifier: Apache-2.0
 */

#include <zephyr/bluetooth/bluetooth.h>
#include <zephyr/bluetooth/hci.h>
#include <zephyr/bluetooth/conn.h>
#include <zephyr/bluetooth/uuid.h>
#include <zephyr/bluetooth/gatt.h>
#include <zephyr/settings/settings.h>
#include <zephyr/net/openthread.h>

#include <zephyr/logging/log.h>
LOG_MODULE_REGISTER(ot_ble_le_task, LOG_LEVEL_INF);

#include "thd_task.h"

/* Channel Sounding RAS Reflector integration */
#define BT_UUID_RAS_SERVICE_VAL 0x185B

#if CONFIG_BT_TLX_CHANNEL_SOUNDING
extern void cs_reflector_init(void);
extern void cs_reflector_on_connected(struct bt_conn *conn, uint8_t err);
extern void cs_reflector_on_disconnected(struct bt_conn *conn);
#endif

/* ============================================================
 * BLE Peripheral section
 * ============================================================
 */

static const struct bt_data ad[] = {
	BT_DATA_BYTES(BT_DATA_FLAGS, (BT_LE_AD_GENERAL | BT_LE_AD_NO_BREDR)),
	BT_DATA_BYTES(BT_DATA_UUID16_SOME, BT_UUID_RAS_SERVICE_VAL & 0xFF,
		      (BT_UUID_RAS_SERVICE_VAL >> 8) & 0xFF),
};

static const struct bt_data sd[] = {
	BT_DATA(BT_DATA_NAME_COMPLETE, CONFIG_BT_DEVICE_NAME, sizeof(CONFIG_BT_DEVICE_NAME) - 1),
};

static void connected(struct bt_conn *conn, uint8_t err)
{
	if (err) {
		printk("Connection failed, err 0x%02x %s\n", err, bt_hci_err_to_str(err));
	} else {
		printk("Connected\n");
	}
#if CONFIG_BT_TLX_CHANNEL_SOUNDING
	cs_reflector_on_connected(conn, err);
#endif
}

static void disconnected(struct bt_conn *conn, uint8_t reason)
{
	printk("Disconnected, reason 0x%02x %s\n", reason, bt_hci_err_to_str(reason));
#if CONFIG_BT_TLX_CHANNEL_SOUNDING
	cs_reflector_on_disconnected(conn);
#endif
}

BT_CONN_CB_DEFINE(conn_callbacks) = {
	.connected = connected,
	.disconnected = disconnected,
};

static void bt_ready(void)
{
	int err = 0;

	printk("Bluetooth initialized\n");

	err = bt_le_adv_start(BT_LE_ADV_CONN_FAST_1, ad, ARRAY_SIZE(ad), sd, ARRAY_SIZE(sd));
	if (err) {
		printk("Advertising failed to start (err %d)\n", err);
		return;
	}

	printk("Advertising successfully started\n");
}

/*
 * static void auth_cancel(struct bt_conn *conn)
 * {
 *	char addr[BT_ADDR_LE_STR_LEN];
 *
 *	bt_addr_le_to_str(bt_conn_get_dst(conn), addr, sizeof(addr));
 *
 *	printk("Pairing cancelled: %s\n", addr);
 * }
 *
 * static struct bt_conn_auth_cb auth_cb_display = {
 *	.cancel = auth_cancel,
 * }
 */

void bt_le_task_init(void)
{
	int err;

	err = bt_enable(NULL);
	if (err) {
		printk("Bluetooth init failed (err %d)\n", err);
		return;
	}

	/* Load bonded keys from flash so reconnects skip re-pairing. */
	if (IS_ENABLED(CONFIG_SETTINGS)) {
		settings_load();
	}
#if CONFIG_BT_TLX_CHANNEL_SOUNDING
	/* Initialize Channel Sounding RAS Reflector */
	cs_reflector_init();
#endif
	bt_ready();

	/* bt_conn_auth_cb_register(&auth_cb_display); */
	k_sleep(K_SECONDS(1));
	static int i;

	if (i == 0) {
		i = 1;
		/* extern struct k_sem controller_sem; */
		/* tlksdk_thd_enableFlexibleTask(THD_TASK_ENABLE); */
		tlksdk_thd_enableInsertTask1(0x01);
		/* k_sem_give(&controller_sem); */

		/*
		 * Start OpenThread only after the BLE/thd coexistence
		 * framework is ready. Otherwise the 802.15.4 radio
		 * start blocks forever on ieee802154_task_ready_sem,
		 * which is only released when the BLE controller hands
		 * the RF over to the Thread insert-task slot.
		 */
		int ot_err = openthread_start(openthread_get_default_context());

		printk("OpenThread start (err %d)\n", ot_err);
	}
}

/* Restart advertising for main.c after re-enabling BLE */
void bt_le_adv_restart(void)
{
	bt_ready();
}
```
