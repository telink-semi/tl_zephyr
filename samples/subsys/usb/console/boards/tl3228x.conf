## soc/telink/tlsr/telink_tlx/Kconfig.soc
```kconfig
# Copyright (c) 2021-2024 Telink Semiconductor
# SPDX-License-Identifier: Apache-2.0

config SOC_RISCV_TELINK_TLX
	bool
	select SOC_FAMILY_TELINK_TLSR
	help
	  Telink TLX

config SOC_SERIES
	default "telink_tlx" if SOC_RISCV_TELINK_TLX

config SOC
	default "telink_tl321x" if SOC_RISCV_TELINK_TL321X
	default "telink_tl322x" if SOC_RISCV_TELINK_TL322X
	default "telink_tl323x" if SOC_RISCV_TELINK_TL323X
	default "telink_tl523x" if SOC_RISCV_TELINK_TL523X
	default "telink_tl721x" if SOC_RISCV_TELINK_TL721X

config NORMAL_MODE
	int "independent matter mode"
	default 0
	help
		This option enables independent matter mode.

config ACTION_DUAL_MODE
	int "action dual mode"
	default 1
	help
		This option enables matter switch mode ,such as by button.

config AUTO_SWITCH_DUAL_MODE
	int "auto switch dual mode"
	default 2
	help
		This option enables matter auto-switch mode ,such as by scan QR code.

config DUAL_MODE
	int "Support dual-mode switch"
	default NORMAL_MODE
	help
		This option enables different dual mode.
```

## soc/telink/tlsr/telink_w9x/Kconfig.defconfig
```kconfig
# Copyright (c) 2024 Telink Semiconductor
# SPDX-License-Identifier: Apache-2.0

if SOC_RISCV_TELINK_W9X

config SYS_CLOCK_EXISTS
	bool
	default y

config SYS_CLOCK_HW_CYCLES_PER_SEC
	int
	default 10000000

config RISCV_SOC_INTERRUPT_INIT
	bool
	default y

config 2ND_LVL_INTR_00_OFFSET
	int
	default 11

config 2ND_LVL_ISR_TBL_OFFSET
	int
	default 12

config NUM_IRQS
	int
	default 59

config MAX_IRQ_PER_AGGREGATOR
	int
	default 59

config XIP
	bool
	default n

config FLASH
	bool
	default y

config FLASH_HAS_EXPLICIT_ERASE
	bool
	default y

config STACK_SENTINEL
	bool
	default y

config THREAD_NAME
	bool
	default y if STACK_SENTINEL

config MAIN_STACK_SIZE
	int
	default 2048

config IDLE_STACK_SIZE
	int
	default 1536

config SYSTEM_WORKQUEUE_STACK_SIZE
	int
	default 2048

config LOG_PROCESS_THREAD_STACK_SIZE
	int
	default 2048

config TEST_EXTRA_STACK_SIZE
	int
	default 1024

config HAS_PM
	default y

config PM_DEVICE
	default y if PM

config COMMON_LIBC_MALLOC
	bool
	default y

config COMMON_LIBC_MALLOC_ARENA_SIZE
	int
	default 65536 if TELINK_OPUS_REMOTE
	default 12288 if NET_L2_OPENTHREAD
	default 8192

config HEAP_MEM_POOL_SIZE
	int
	default 4096

config HAS_FLASH_LOAD_OFFSET
	bool
	default y if BOOTLOADER_MCUBOOT

config NVS
	bool
	default y if OPENTHREAD
	depends on FLASH
	depends on FLASH_PAGE_LAYOUT

if SETTINGS_NVS
# Workaround for not being able to have commas in macro arguments
DT_LABEL_Z_STORAGE := $(dt_nodelabel_path,storage_partition)

# Set the sector count of NVS as the storage partition size divided by the sector size (4 KB)
config SETTINGS_NVS_SECTOR_COUNT
	int
	default $(shell,expr $(dt_node_reg_size_int,$(DT_LABEL_Z_STORAGE),0,K) / 4)
endif # SETTINGS_NVS

endif # SOC_RISCV_TELINK_W9X
```

## soc/telink/tlsr/telink_w9x/opus/Kconfig.opus
```kconfig
# Copyright (c) 2025 Telink Semiconductor
# SPDX-License-Identifier: Apache-2.0

config TELINK_W91_OPUS_CODEC
	bool "Telink W91 OPUS CODEC"
	default n
	help
		This option allows Telink W91 OPUS CODEC library usage.

if TELINK_W91_OPUS_CODEC

config TELINK_W91_OPUS_LIB_VERSION
	int "Telink W91 OPUS library GCC version"
	default 12
	help
		This option defines Telink W91 OPUS library GCC version.

# BLOCKING, RAMCODE not needed

endif # TELINK_W91_OPUS_CODEC
```

## soc/telink/tlsr/telink_w9x/ot_rcp/Kconfig.ot_rcp
```kconfig
# Copyright (c) 2025 Telink Semiconductor
# SPDX-License-Identifier: Apache-2.0

if IEEE802154

config TELINK_W91_OT_RCP
	bool "Telink W91 Openthread spinel interface"
	default y
	help
		This option enables Telink W91 Openthread RCP interface.

endif # IEEE802154
```

## soc/telink/tlx/Kconfig.defconfig
```kconfig
# Copyright (c) 2026 Telink Semiconductor
# SPDX-License-Identifier: Apache-2.0

if SOC_FAMILY_TELINK_TLX

rsource "*/Kconfig.defconfig"

endif # SOC_FAMILY_TELINK_TLX
```

## soc/telink/tlx/Kconfig.soc
```kconfig
# Copyright (c) 2026 Telink Semiconductor
# SPDX-License-Identifier: Apache-2.0

choice SOC_TELINK_TLX_CHOICE
	prompt "Telink TLX Family SoCs implementation"
	default SOC_FAMILY_TELINK_TLX_NONE

config SOC_FAMILY_TELINK_TLX_NONE
	bool "TLX family SoC deselected"
	help
	  No TLX family SoC selected

config SOC_RISCV_TELINK_TL521X
	bool "Telink TL521X SoC implementation"
	select SOC_SERIES_RISCV_TELINK_TL521X
	help
	  Telink TL521X

config SOC_RISCV_TELINK_TL321X
	bool "Telink TL321 SoC implementation"
	select SOC_SERIES_RISCV_TELINK_TL321X
	help
	  Telink TL321X

config SOC_RISCV_TELINK_TL322X
	bool "Telink TL322 SoC implementation"
	select SOC_SERIES_RISCV_TELINK_TL322X
	help
	  Telink TL322X

config SOC_RISCV_TELINK_TL323X
	bool "Telink TL323 SoC implementation"
	select SOC_SERIES_RISCV_TELINK_TL323X
	help
	  Telink TL323X

config SOC_RISCV_TELINK_TL721X
	bool "Telink TL721 SoC implementation"
	select SOC_SERIES_RISCV_TELINK_TL721X
	help
	  Telink TL721X

config SOC_RISCV_TELINK_TL523X
	bool "Telink TL523 SoC implementation"
	select SOC_SERIES_RISCV_TELINK_TL5X
	help
	  Telink TL523X

endchoice

config SOC_FAMILY_TELINK_TLX
	bool

config SOC_FAMILY
	default "telink_tlx" if SOC_FAMILY_TELINK_TLX

rsource "*/Kconfig.soc"
```

## soc/telink/tlx/telink_tl322x/Kconfig.n22
```kconfig
# Copyright (c) 2024 Telink Semiconductor
# SPDX-License-Identifier: Apache-2.0

config TELINK_TL322X_ENABLE_N22
	bool "N22 core support"
	default n
	depends on SOC_FAMILY_TELINK_TLX
	help
		This option enables N22 usage.

config TELINK_TL322X_N22_HART
	int "N22 HART ID"
	default 1
	depends on SOC_FAMILY_TELINK_TLX && TELINK_TL322X_ENABLE_N22
	help
		This option sets N22 HART ID.

config TELINK_TL322X_FETCH_N22_BIN
	bool "Fetch N22 binary after build"
	default y
	depends on SOC_FAMILY_TELINK_TLX && TELINK_TL322X_ENABLE_N22
	help
		This option fetching N22 binary after build.

config TELINK_TL322X_FETCH_N22_BIN_REVISION
	string "N22 binaries revision"
	default "c8397b726468c1c63b098bc06eec2d9acad4887d"
	depends on TELINK_TL322X_FETCH_N22_BIN && TELINK_TL322X_ENABLE_N22
	help
		This option sets N22 binary revision.

config TELINK_TL322X_N22_PARTITION_ADDR
	hex "N22 partition address"
	depends on SOC_FAMILY_TELINK_TLX && TELINK_TL322X_ENABLE_N22
	default $(dt_node_reg_addr_hex,$(dt_nodelabel_path,n22_partition),0)

config TELINK_TL322X_N22_MATTER_OTA_LAYOUT
	bool "Support Matter dual core OTA"
	depends on TELINK_TL322X_FETCH_N22_BIN && TELINK_TL322X_ENABLE_N22
	default n
	help
		This option enables support Matter dual core OTA
```

## soc/telink/tlx/telink_tl521x/Kconfig.soc
```kconfig
# Copyright (c) 2021-2026 Telink Semiconductor
# SPDX-License-Identifier: Apache-2.0

config SOC_SERIES_RISCV_TELINK_TL521X
	bool
	select SOC_FAMILY_TELINK_TL
	help
	  Telink TL521X Series

config SOC_SERIES
	default "telink_tl521x" if SOC_SERIES_RISCV_TELINK_TL521X

config SOC
	default "telink_tl521x" if SOC_RISCV_TELINK_TL521X

config NORMAL_MODE
	int "independent matter mode"
	default 0
	help
		This option enables independent matter mode.

config ACTION_DUAL_MODE
	int "action dual mode"
	default 1
	help
		This option enables matter switch mode ,such as by button.

config AUTO_SWITCH_DUAL_MODE
	int "auto switch dual mode"
	default 2
	help
		This option enables matter auto-switch mode ,such as by scan QR code.

config DUAL_MODE
	int "Support dual-mode switch"
	default NORMAL_MODE
	help
		This option enables different dual mode.
```

## soc/telink/tlx/telink_tl5x/Kconfig
```kconfig
# Copyright (c) 2024 Telink Semiconductor
# SPDX-License-Identifier: Apache-2.0

config SOC_SERIES_RISCV_TELINK_TL5X
	bool
	select RISCV
	select RISCV_ISA_RV32I
	select RISCV_ISA_EXT_M
	select RISCV_ISA_EXT_A
	select RISCV_ISA_EXT_C
	select RISCV_ISA_EXT_ZICSR
	select RISCV_ISA_EXT_ZIFENCEI
	select RISCV_PRIVILEGED
	select RISCV_HAS_PLIC
	select HAS_TELINK_DRIVERS
	select RISCV_SOC_HAS_GP_RELATIVE_ADDRESSING
	select ATOMIC_OPERATIONS_BUILTIN
	select CPU_HAS_FPU
	select INCLUDE_RESET_VECTOR
	select PINCTRL
	imply XIP
	select SOC_EARLY_INIT_HOOK
	select ARCH_HAS_CUSTOM_CPU_IDLE

if SOC_SERIES_RISCV_TELINK_TL5X

config TELINK_TL523X_PMP
	bool "Support Hardware Memory Protection"
	select RISCV_PMP
	help
		This option enables Telink TL523X PMP(memory protection) module.

config TELINK_TLX_PFT
	bool "Support performance throttling"
	default y
	select RISCV_SOC_CONTEXT_SAVE

# To pass CI on Zephyr 4.1
config BOOT_USE_MBEDTLS
	bool

config TELINK_TLX_MBEDTLS_HW_ACCELERATION
	bool "Use Telink TLx platform mbedtls HW acceleration"
	depends on MBEDTLS || BOOT_USE_MBEDTLS
	default y
	help
		This option enables Telink TLx hardware accelerated mbedtls version.

# To pass CI on Zephyr 4.1
config BOOT_USE_TINYCRYPT
	bool

config TELINK_TLX_TINYCRYPT_HW_ACCELERATION
	bool "Use Telink TLx platform tinycrypt HW acceleration"
	depends on TINYCRYPT || BOOT_USE_TINYCRYPT
	default y
	help
		This option enables Telink TLx hardware accelerated tinycrypt version.

config TELINK_SOC_REBOOT_ON_FAULT
	bool "Reboot system when fault happened"
	help
		This option enables Telink TLx chip reboot after fault.

config TELINK_SOC_REBOOT_ON_FAULT_DELAY
	int "Reboot system delay in mS"
	depends on TELINK_SOC_REBOOT_ON_FAULT
	default 1000
	range 0 30000
	help
		This option sets Telink TLx chip reboot on fault delay in mS.

config TELINK_TLX_USB_SWI_DISABLE
	bool "Don't use USB SWI interface"
	help
		This option disables USB SWI interface

config TELINK_TLX_2_WIRE_SPI_ENABLE
	bool "Use 2-wire SPI interface to FLASH"
	help
		This option enables 2-wire SPI interface to FLASH

config TELINK_TLX_MALLOC_FAILED_HOOK
	bool "Stop SW execution when system heap allocation failed"
	default y
	help
		This option stops SW execution when system heap allocation failed.

config SOC_SERIES_RISCV_TELINK_TL5X_RETENTION
	bool "Telink TL5X SoCs retention memory layout"
	help
		Telink TL5X SoCs retention memory layout

config SOC_SERIES_RISCV_TELINK_TL5X_NON_RETENTION_RAM_CODE
	bool "Telink TL5X SoCs non retention ram code"
	depends on SOC_SERIES_RISCV_TELINK_TL5X_RETENTION
	help
		Place Telink TL5X SoCs ram code in non-retention area
		and restore this are after each retention.

if BOOTLOADER_MCUBOOT || MCUBOOT

config TELINK_TLX_MCUBOOT_STARTUP
	bool "Telink TLx MCUBoot startup handler"
	depends on MCUBOOT
	select CRC
	select UART_DRV_CMD
	default n
	help
		Run Telink specific vendor code before MCUBoot
		main process

config LZMA
	bool "LZMA data compression and decompression"
	help
	  This option enables lzma compression & decompression library
	  support.

config COMPRESS_LZMA
	bool "Support LZMA compression"
	default n
	select LZMA
	select BOOT_IMAGE_ACCESS_HOOKS
	help
		This option enables LZMA compression with MCUBoot

config COMPRESS_LZMA_DICTIONARY_SIZE
	int "Set LZMA compression dictionary size"
	default 32768
	depends on COMPRESS_LZMA
	help
		This option sets LZMA compression dictionary size

config TELINK_TLX_MATTER_RETENTION_LAYOUT
	bool "Support Matter retention layout"
	depends on SOC_SERIES_RISCV_TELINK_TL5X_RETENTION
	help
		This option enables support Matter retention layout

endif # BOOTLOADER_MCUBOOT || MCUBOOT

endif # SOC_SERIES_RISCV_TELINK_TL5X
```

## soc/telink/tlx/telink_tl5x/Kconfig.soc
```kconfig
# Copyright (c) 2021-2024 Telink Semiconductor
# SPDX-License-Identifier: Apache-2.0

config SOC_SERIES_RISCV_TELINK_TL5X
	bool
	select SOC_FAMILY_TELINK_TLX
	help
	  Telink TL5X Series

config SOC_SERIES
	default "telink_tl5x" if SOC_SERIES_RISCV_TELINK_TL5X

config SOC
	default "telink_tl5238x" if SOC_RISCV_TELINK_TL523X

config NORMAL_MODE
	int "independent matter mode"
	default 0
	help
		This option enables independent matter mode.

config ACTION_DUAL_MODE
	int "action dual mode"
	default 1
	help
		This option enables matter switch mode ,such as by button.

config AUTO_SWITCH_DUAL_MODE
	int "auto switch dual mode"
	default 2
	help
		This option enables matter auto-switch mode ,such as by scan QR code.

config DUAL_MODE
	int "Support dual-mode switch"
	default NORMAL_MODE
	help
		This option enables different dual mode.
```
