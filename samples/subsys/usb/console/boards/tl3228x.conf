## soc/riscv/riscv-privilege/Kconfig
```kconfig
# Configuration options for riscv SOCs supporting the riscv privileged
# architecture specification

# Copyright (c) 2017 Jean-Paul Etienne <fractalclone@gmail.com>
# SPDX-License-Identifier: Apache-2.0

config SOC_FAMILY_RISCV_PRIVILEGE
	bool

config SOC_FAMILY
	string
	default "riscv-privilege"
	depends on SOC_FAMILY_RISCV_PRIVILEGE

config RISCV_HAS_PLIC
	bool "Does the SOC provide support for a Platform Level Interrupt Controller (PLIC)"
	depends on SOC_FAMILY_RISCV_PRIVILEGE
	help
	  Does the SOC provide support for a Platform Level Interrupt Controller (PLIC).

config RISCV_HAS_CLIC
	bool "Does the SOC provide support for a Core-Local Interrupt Controller (CLIC)"
	depends on SOC_FAMILY_RISCV_PRIVILEGE
	help
	  Does the SOC provide support for a Core-Local Interrupt Controller (CLIC).

config RISCV_MTVEC_VECTORED_MODE
	bool "Should the SOC use mtvec in vectored mode"
	depends on SOC_FAMILY_RISCV_PRIVILEGE
	help
	  Should the SOC use mtvec in vectored mode

# Fix ram overflow during bootloader compilation after config LZMA
config TELINK_TLX_MATTER_RETENTION_LAYOUT
	bool "link mcu_boot_tlx.ld for tl3218x"
	default y if BOARD_TL3218X
	default y if BOARD_TL3238X
	default n
	help
	  link mcu_boot_tlx.ld for tl3218x

source "soc/riscv/riscv-privilege/*/Kconfig.soc"
```

## soc/riscv/riscv-privilege/telink_common/otbr/Kconfig.otbr
```kconfig
# Copyright (c) 2025 Telink Semiconductor
# SPDX-License-Identifier: Apache-2.0

config TELINK_OTBR
	bool "Telink Thread border router"
	select NETWORKING
	select NET_CONFIG_SETTINGS
	select NET_L2_ETHERNET
	select NET_L2_OPENTHREAD
	select NET_L2_ETHERNET_MGMT
	select WIFI
	select OPENTHREAD_MANUAL_START
	select SHELL
	select OPENTHREAD_SHELL
	select OPENTHREAD_BORDER_ROUTER
	select OPENTHREAD_BORDER_ROUTING
	select OPENTHREAD_BORDER_ROUTING_COUNTERS
	select OPENTHREAD_SRP_SERVER
	select OPENTHREAD_ENABLE_SERVICE
	select OPENTHREAD_SLAAC
	select OPENTHREAD_EXTERNAL_HEAP
	select NET_ROUTING
	select NET_SOCKETS
	select NET_SOCKETS_SERVICE
	help
		This option enables Telink Thread border router.

if TELINK_OTBR

choice
	prompt "Telink OTBR log level"
	default TELINK_OTBR_LOG_LEVEL_INFO
	help
		This option selects log level for Telink OTBR.
config TELINK_OTBR_LOG_LEVEL_CRIT
	bool "Critical"
config TELINK_OTBR_LOG_LEVEL_WARN
	bool "Warning"
config TELINK_OTBR_LOG_LEVEL_INFO
	bool "Informational"
config TELINK_OTBR_LOG_LEVEL_DEBG
	bool "Debug"
endchoice

config TELINK_OTBR_LOG_LEVEL
	int
	default 1 if TELINK_OTBR_LOG_LEVEL_CRIT
	default 2 if TELINK_OTBR_LOG_LEVEL_WARN
	default 3 if TELINK_OTBR_LOG_LEVEL_INFO
	default 4 if TELINK_OTBR_LOG_LEVEL_DEBG
	default 0

config NET_CONFIG_AUTO_INIT
	bool "Init networking support automatically during device startup"
	default n

config TELINK_OTBR_INIT_PRIO
	int "Startup priority for the Telink OTBR"
	depends on !NET_CONFIG_AUTO_INIT
	default 90

config NET_IF_MAX_IPV6_COUNT
	int "Max number of IPv6 network interfaces in the system"
	default 2

config NET_SOCKETS_SERVICE_STACK_SIZE
	int "Stack size for the thread handling socket services"
	default 2048

config NET_HOSTNAME_ENABLE
	bool "Add hostname to the device"
	default n

config TELINK_OTBR_HOST_NAME
	string "DNS host name"
	default "telink-otbr"

config TELINK_OTBR_MDNS_THREAD_PRIORITY
	int "Telink OTBR MDNS thread priority"
	default 0
	help
		This option sets Telink OTBR MDNS thread priority.

config TELINK_OTBR_MDNS_THREAD_STACK_SIZE
	int "Telink OTBR MDNS thread stack size"
	default 2048
	help
		This option sets Telink OTBR MDNS thread stack size.

config TELINK_OTBR_WIFI_SSID
	string "WIFI SSID - Network name"

config TELINK_OTBR_WIFI_PASSWORD
	string "WIFI PSK - Network password"

endif # TELINK_OTBR
```

## soc/telink/tlsr/Kconfig
```kconfig
# Copyright (c) 2026 Telink Semiconductor
# SPDX-License-Identifier: Apache-2.0

if SOC_FAMILY_TELINK_TLSR

rsource "*/Kconfig"
if IEEE802154
rsource "common/ot_rcp/Kconfig.ot_rcp"
endif # IEEE802154
if SOC_RISCV_TELINK_W9X
rsource "common/ipc/Kconfig.ipc"
rsource "common/blocking_core/Kconfig.blocking"
rsource "common/core_heartbeat/Kconfig.heartbeat"
rsource "common/otbr/Kconfig.otbr"
rsource "common/opus/Kconfig.opus"
endif # SOC_RISCV_TELINK_W9X

endif # SOC_FAMILY_TELINK_TLSR
```

## soc/telink/tlsr/Kconfig.defconfig
```kconfig
# Copyright (c) 2026 Telink Semiconductor
# SPDX-License-Identifier: Apache-2.0

if SOC_FAMILY_TELINK_TLSR

rsource "*/Kconfig.defconfig"

endif # SOC_FAMILY_TELINK_TLSR
```

## soc/telink/tlsr/Kconfig.soc
```kconfig
# Copyright (c) 2026 Telink Semiconductor
# SPDX-License-Identifier: Apache-2.0

choice SOC_TELINK_TLSR_CHOICE
	prompt "Telink TLSR Family SoCs implementation"
	default SOC_RISCV_TELINK_TLSR_NONE

config SOC_RISCV_TELINK_TLSR_NONE
	bool "TLSR family SoC deselected"
	help
	  No TLSR family SoC selected

config SOC_RISCV_TELINK_B91
	bool "Telink B91 SoC implementation"
	select SOC_RISCV_TELINK_B9X
	help
	  Telink B91

config SOC_RISCV_TELINK_B92
	bool "Telink B92 SoC implementation"
	select SOC_RISCV_TELINK_B9X
	help
	  Telink B92

config SOC_RISCV_TELINK_W91
	bool "Telink W91 SoC implementation"
	select SOC_RISCV_TELINK_W9X
	help
	  Telink W91

endchoice

config SOC_FAMILY_TELINK_TLSR
	bool

config SOC_FAMILY
	default "telink_tlsr" if SOC_FAMILY_TELINK_TLSR

rsource "*/Kconfig.soc"
```

## soc/telink/tlsr/common/blocking_core/Kconfig.blocking
```kconfig
# Copyright (c) 2024-2026 Telink Semiconductor
# SPDX-License-Identifier: Apache-2.0

config TELINK_BLOCKING_CORE
	bool "Telink blocking core"
	default y
	help
		This option enables Telink blocking core.

if TELINK_BLOCKING_CORE

config BLOCKING_CORE_TELINK_CORE_STOP_TIMEOUT_MS
	int "Core stop timeout"
	default 100
	help
	  This option sets core stop timeout in uS.

endif # TELINK_BLOCKING_CORE
```

## soc/telink/tlsr/common/core_heartbeat/Kconfig.heartbeat
```kconfig
# Copyright (c) 2024-2026 Telink Semiconductor
# SPDX-License-Identifier: Apache-2.0

config TELINK_CORE_HEARTBEAT
	bool "Telink intercore heartbeat"
	default y
	depends on !PM
	help
		This option enables Telink heartbeat messages between cores.

if TELINK_CORE_HEARTBEAT

config CORE_HEARTBEAT_TELINK_TIMEOUT_MS
	int "Heartbeat signal interval, ms"
	default 2000
	help
	  This option sets heartbeat timeout in mS.

endif # TELINK_CORE_HEARTBEAT
```

## soc/telink/tlsr/common/opus/Kconfig.opus
```kconfig
# Copyright (c) 2025 Telink Semiconductor
# SPDX-License-Identifier: Apache-2.0

config TELINK_OPUS_REMOTE
	bool "Telink OPUS codec IPC remote backend"
	select TELINK_W91_IPC_DISPATCHER
	help
		This option enables Telink OPUS codec IPC remote backend.

if TELINK_OPUS_REMOTE

config TELINK_OPUS_REMOTE_LIB
	string "Telink OPUS codec library"
	default "libtelink-opus.a"
	help
		This option defines Telink OPUS codec library.

config TELINK_OPUS_REMOTE_LIB_SHA256
	string "Telink OPUS codec library SHA256"
	default "da9987dd74b166ed55d734f2810303d9bdb4b84d627f9510b98e643def9ccecf"
	help
		This option defines Telink OPUS codec library SHA256.

config TELINK_OPUS_REMOTE_LIB_HEADER
	string "Telink OPUS codec library header"
	default "tlka_opus_api.h"
	help
		This option defines Telink OPUS codec library header.

config TELINK_OPUS_REMOTE_LIB_HEADER_SHA256
	string "Telink OPUS codec library header SHA256"
	default "cb859ea3f64707fd1a4f01d85380abf4a17b250f3ccc3a16505622620437e325"
	help
		This option defines Telink OPUS codec library header SHA256.

choice
	prompt "Telink OPUS codec IPC remote backend log level"
	default TELINK_OPUS_REMOTE_LOG_LEVEL_INFO
	help
		This option selects log level for OPUS codec IPC remote backend.

config TELINK_OPUS_REMOTE_LOG_LEVEL_CRIT
	bool "Critical"
config TELINK_OPUS_REMOTE_LOG_LEVEL_WARN
	bool "Warning"
config TELINK_OPUS_REMOTE_LOG_LEVEL_INFO
	bool "Informational"
config TELINK_OPUS_REMOTE_LOG_LEVEL_DEBG
	bool "Debug"
endchoice

config TELINK_OTBR_LOG_LEVEL
	int
	default 1 if TELINK_OPUS_REMOTE_LOG_LEVEL_CRIT
	default 2 if TELINK_OPUS_REMOTE_LOG_LEVEL_WARN
	default 3 if TELINK_OPUS_REMOTE_LOG_LEVEL_INFO
	default 4 if TELINK_OPUS_REMOTE_LOG_LEVEL_DEBG
	default 0

config TELINK_OPUS_REMOTE_INIT_PRIO
	int "Startup priority for the Telink OPUS codec IPC remote backend"
	default 90

config TELINK_OPUS_REMOTE_THREAD_PRIORITY
	int "Telink OPUS codec IPC remote backend thread priority"
	default 0
	help
		This option sets Telink OPUS codec IPC remote backend thread priority.

config TELINK_OPUS_REMOTE_THREAD_STACK_SIZE
	int "Telink OPUS codec IPC remote backend thread stack size"
	default 20480
	help
		This option sets Telink OPUS codec IPC remote backend thread stack size.

endif # TELINK_OPUS_REMOTE
```

## soc/telink/tlsr/common/ot_ext/Kconfig.ot_ext
```kconfig
# Copyright (c) 2025 Telink Semiconductor
# SPDX-License-Identifier: Apache-2.0

if NET_L2_OPENTHREAD

choice OPENTHREAD_IMPLEMENTATION
	default OPENTHREAD_SOURCES

config OPENTHREAD_TELINK_LIB
	bool "OpenThread link against Telink library"
	help
	  Use Zephyr's OpenThread Telink library.

endchoice

if OPENTHREAD_TELINK_LIB

config TELINK_OPENTHREAD_LIB
	string "Telink openthread library"
	default "libtelink-openthread-3ae741f95e7dfb391dec35c48742862049eb62e8-001-strip.a"
	help
		This option defines Telink openthread library.

config TELINK_OPENTHREAD_LIB_SHA256
	string "Telink openthread library SHA256"
	default "24ebfd46e256d2aafcc1e7e10d4b3bd0980dc3637ae93c6b4afdae700e4967a2"
	help
		This option defines Telink openthread library SHA256.

endif # OPENTHREAD_TELINK_LIB

endif # NET_L2_OPENTHREAD
```

## soc/telink/tlsr/common/ot_rcp/Kconfig.ot_rcp
```kconfig
# Copyright (c) 2025 Telink Semiconductor
# SPDX-License-Identifier: Apache-2.0

if IEEE802154

config TELINK_OT_RCP
	bool
	select RING_BUFFER
	select CRC
	depends on IEEE802154_TELINK_RCP
	help
		This option enables Telink Openthread RCP interface.

if TELINK_OT_RCP

config OPENTHREAD_RADIO_WORKQUEUE_STACK_SIZE
	default 2048

choice TELINK_OT_RCP_TRANSPORT
	bool "Transport for the OT RCP"
	default TELINK_OT_RCP_TRANSPORT_UART

	config TELINK_OT_RCP_TRANSPORT_UART
		bool "Set UART as a transport for the OT RCP"

	config TELINK_OT_RCP_TRANSPORT_DUMMY
		bool "Set dummy as a transport for the OT RCP"

endchoice # TELINK_OT_RCP_TRANSPORT

config TELINK_OT_RCP_SYNC_TIME_OFFSET_MS
	int "Time to recalculate offset (ms)"
	default 2000
	help
		This option sets time to recalculate offset with RCP

config TELINK_OT_RCP_BUFFER_SIZE
	int "Telink Openthread RCP UART TX/RX buffer size"
	default 256
	help
		This option sets Telink Openthread RCP UART TX/RX buffer size.

config TELINK_OT_RCP_THREAD_PRIORITY
	int "Telink Openthread spinel interface reception thread priority"
	default 0
	help
		This option sets Telink Openthread RCP reception thread priority.

config TELINK_OT_RCP_THREAD_STACK_SIZE
	int "Telink Openthread spinel interface reception thread stack size"
	default 2048
	help
		This option sets Telink Openthread RCP reception thread stack size.

config TELINK_OT_SPINEL_RX_BUFFER_SIZE
	int "Telink Openthread spinel reception buffer size"
	default 256
	help
		This option sets Telink Openthread spinel reception buffer size.

config TELINK_OT_SPINEL_RX_BUFFER_COUNT
	int "Telink Openthread spinel reception buffers count"
	default 4
	help
		This option sets Telink Openthread spinel reception buffers count.

config TELINK_OT_SPINEL_RESPONSE_TIMEOUT_MS
	int "Telink Openthread spinel response timeout, mS"
	default 100
	help
		This option sets Telink Openthread spinel response timeout, mS.

endif # TELINK_OT_RCP

endif # IEEE802154
```

## soc/telink/tlsr/common/tlsr_profiler/Kconfig.tlsr_profiler
```kconfig
# Copyright (c) 2026 Telink Semiconductor
# SPDX-License-Identifier: Apache-2.0

config TLSR_PROFILER
	bool "Telink profiler"
	depends on SOC_RISCV_TELINK_TLX || SOC_RISCV_TELINK_B9X
	help
		This option enables Telink profiling feature.

if TLSR_PROFILER

config TLSR_PROFILER_AUTOSTART
	bool "Telink profiler antostart"
	default y
	help
		This option enables Telink profiling feature autostart.

config TLSR_PROFILER_ITEMS
	int "Telink profiler items"
	default 128
	help
		This option sets Telink profiler items count.

endif # TLSR_PROFILER
```

## soc/telink/tlsr/telink_tl5x/Kconfig
```kconfig
# Copyright (c) 2024 Telink Semiconductor
# SPDX-License-Identifier: Apache-2.0

config SOC_RISCV_TELINK_TL5X
	bool
	select RISCV
	select RISCV_ISA_RV32I
	select RISCV_ISA_EXT_M
	select RISCV_ISA_EXT_A
	select RISCV_ISA_EXT_C
	select RISCV_ISA_EXT_ZICSR
	select RISCV_ISA_EXT_ZIFENCEI
	select RISCV_PRIVILEGED
	select RISCV_HAS_PLIC
	select HAS_TELINK_DRIVERS
	select RISCV_SOC_HAS_GP_RELATIVE_ADDRESSING
	select ATOMIC_OPERATIONS_BUILTIN
	select CPU_HAS_FPU
	select INCLUDE_RESET_VECTOR
	select PINCTRL
	imply XIP
	select SOC_EARLY_INIT_HOOK
	select ARCH_HAS_CUSTOM_CPU_IDLE

if SOC_RISCV_TELINK_TL5X

config TELINK_TL523X_PMP
	bool "Support Hardware Memory Protection"
	depends on SOC_RISCV_TELINK_TL523X
	select RISCV_PMP
	help
		This option enables Telink TL523X PMP(memory protection) module.

config TELINK_TLX_MBEDTLS_HW_ACCELERATION
	bool "Use Telink TLx platform mbedtls HW acceleration"
	depends on MBEDTLS
	default y
	help
		This option enables Telink TLx hardware accelerated mbedtls version.

config TELINK_TLX_PFT
	bool "Support performance throttling"
	default y
	select RISCV_SOC_CONTEXT_SAVE

config TELINK_TLX_MBEDTLS_HW_ACCELERATION
	bool "Use Telink TLx platform mbedtls HW acceleration"
	depends on MBEDTLS
	default y
	help
		This option enables Telink TLx hardware accelerated mbedtls version.

config TELINK_TLX_MBEDTLS_HW_SHA_ACCELERATION
	bool "Use Telink TLx platform mbedtls HW SHA256 acceleration"
	depends on TELINK_TLX_MBEDTLS_HW_ACCELERATION
	default y if MCUBOOT
	help
		This option enables Telink TLx hardware accelerated
		SHA256 for MbedTLS in bootloader only.

config TELINK_SOC_REBOOT_ON_FAULT
	bool "Reboot system when fault happened"
	help
		This option enables Telink TLx chip reboot after fault.

config TELINK_SOC_REBOOT_ON_FAULT_DELAY
	int "Reboot system delay in mS"
	depends on TELINK_SOC_REBOOT_ON_FAULT
	default 1000
	range 0 30000
	help
		This option sets Telink TLx chip reboot on fault delay in mS.

config TELINK_TLX_USB_SWI_DISABLE
	bool "Don't use USB SWI interface"
	help
		This option disables USB SWI interface

config TELINK_TLX_2_WIRE_SPI_ENABLE
	bool "Use 2-wire SPI interface to FLASH"
	help
		This option enables 2-wire SPI interface to FLASH

config TELINK_TLX_MALLOC_FAILED_HOOK
	bool "Stop SW execution when system heap allocation failed"
	default y
	help
		This option stops SW execution when system heap allocation failed.

config SOC_SERIES_RISCV_TELINK_TLX_RETENTION
	bool "Telink TLx SoCs retention memory layout"
	help
		Telink TLx SoCs retention memory layout

config SOC_SERIES_RISCV_TELINK_TLX_NON_RETENTION_RAM_CODE
	bool "Telink TLx SoCs non retention ram code"
	depends on SOC_SERIES_RISCV_TELINK_TLX_RETENTION
	help
		Place Telink Tlx SoCs ram code in non-retention area
		and restore this are after each retention.

config TELINK_TLX_MATTER_RETENTION_LAYOUT
	bool "Support Matter retention layout"
	depends on SOC_SERIES_RISCV_TELINK_TLX_RETENTION
	help
		This option enables support Matter retention layout
		
endif # SOC_RISCV_TELINK_TL5X

source "soc/telink/tlsr/telink_tlx/Kconfig.n22"
```
