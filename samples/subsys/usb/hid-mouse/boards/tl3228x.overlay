&cpu0 {
	/* USB0 digital voltage must be 1.1V and HCLK min's 48M */
	clock-frequency = <192000000>;
};

&uart0 {
	status = "okay";
	/* Baud rate for serial port logging */
	current-speed = <2000000>;
};
