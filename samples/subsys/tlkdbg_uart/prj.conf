## CMakeLists.txt
```
# Copyright (c) 2026 Telink Semiconductor
# SPDX-License-Identifier: Apache-2.0

cmake_minimum_required(VERSION 3.20.0)
find_package(Zephyr REQUIRED HINTS $ENV{ZEPHYR_BASE})
project(tlkdbg_uart)

target_sources(app PRIVATE src/main.c)
```

## prj.conf
```kconfig
# Copyright (c) 2026 Telink Semiconductor
# SPDX-License-Identifier: Apache-2.0

# tlkdbg owns the board UART; the console/log subsystem must be off.
CONFIG_TLKDBG=y
CONFIG_TLKDBG_UART_BAUD=3000000
CONFIG_TLKDBG_UART_INSTANCE=0
CONFIG_TLKDBG_UART_DMA_CH=7
CONFIG_TLKDBG_POLL_THREAD=y
CONFIG_TLKDBG_LABEL_TABLE=y
CONFIG_TLKDBG_LABEL_ROOTS="."

CONFIG_CONSOLE=n
CONFIG_UART_CONSOLE=n
CONFIG_LOG=n
CONFIG_BOOT_BANNER=n
CONFIG_PRINTK=n
CONFIG_SERIAL=n
CONFIG_UART_TELINK_TLX=n
CONFIG_UART_INTERRUPT_DRIVEN=n
```

## boards/tl3238x.overlay
```dts
/*
 * Copyright (c) 2026 Telink Semiconductor
 * SPDX-License-Identifier: Apache-2.0
 *
 * The console UART is handed over to tlkdbg: the Zephyr UART instance is
 * disabled and the TX pin (PB2) is muxed by the tlkdbg component itself.
 */

/* pclk must be 48 MHz for an exact 3 Mbps UART clock:
 * baud = pclk / ((div+1)*(bwpc+1)); with CCLK=48 the SoC selects pclk=12 MHz
 * and 3 Mbps would come out as 2.4 Mbps. CCLK=96 gives HCLK=48/PCLK=48. */
&cpu0 {
	clock-frequency = <96000000>;
};

&uart0 {
	status = "disabled";
};

/ {
	tlkdbg_uart: tlkdbg-uart {
		compatible = "telink,tlkdbg-uart";
		status = "okay";
		pinctrl-0 = <&uart0_tx_pb2_default>;
		pinctrl-names = "default";
	};
};
```

## src/main.c
```c
/*
 * Copyright (c) 2026 Telink Semiconductor
 * SPDX-License-Identifier: Apache-2.0
 *
 * tlkdbg UART demo: emits a 1 ms VCD pattern plus LOG records in the
 * usbtraceplus wire format. The PC must be configured with mhz = 24.
 */
#include <zephyr/kernel.h>

#include <tlkdbg.h>

/* Signal IDs. Mirror these in the PC-side .def file:
 *   SLEV_timestamp 0   (timestamp; SID 0 is reserved)
 *   SL01_task_test 1
 *   SL16_counter   1
 *   SL24_FCNT      1
 */
#define SLEV_timestamp 0
#define SL01_task_test 1
#define SL16_counter   1
#define SL24_FCNT      1

int main(void)
{
	if (tlkdbg_init() != 0) {
		return 0;
	}

	LOG_STR_DYNAMIC("boot", "tlkdbg uart demo", 16);

	unsigned int seq = 0;

	while (1) {
		vcd_tick(SLEV_timestamp);
		vcd_task(SL01_task_test, 1);
		vcd_b24(SL24_FCNT, seq & 0xffffffu);
		vcd_b16(SL16_counter, seq & 0xffffu);
		vcd_task(SL01_task_test, 0);

		if ((seq % 100u) == 0u) {
			unsigned int v = seq;

			/* Build-time hash label (type 4); the text is scanned by
			 * tlkdbg_label_gen.py and only the 2-byte hash is sent. */
			LOG_STR_DATA(fcnt, "FCNT", &v, sizeof(v));
		}

		seq++;
		k_sleep(K_MSEC(1));
	}

	return 0;
}
```
