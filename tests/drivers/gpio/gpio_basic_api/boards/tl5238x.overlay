/*
 * Copyright (c) 2026 Telink Semiconductor
 *
 * SPDX-License-Identifier: Apache-2.0
 *
 * TL5238X (tl5238x) loopback wiring for the gpio_basic_api test.
 *
 * Pin assignment matches the tl5238x board devicetree
 * (boards/telink/tl523x/tl5238x-common.dtsi):
 *   - PD2 = led_white (LED White)
 *   - PD3 = led_green (LED Green)
 *
 * NOTE: tl5238x is currently NOT buildable in this tree because the
 * Telink BLE SDK HAL for TL523X is incomplete:
 *   - drivers/gpio/gpio_tl5x.c fails on missing header "analog.h".
 *   - linking fails on missing prebuilt lib
 *     modules/hal/telink_ble_sdk/tl_ble_sdk/proj_lib/zephyr/tl523x/
 *     lib_zephyr_tl523x_peripheral.a.
 * To be resolved by the BLE team (zhihan / strandingneko-vivi).
 *
 * Hardware setup
 * ==============
 * Short PD2 (LED White) to PD3 (LED Green) on the TL5238X EVK with a
 * jumper wire. The test drives the output pin (PD2) and reads the edges
 * on the input pin (PD3), so the two pads must be electrically connected.
 * Open a serial console at 115200 8N1 to observe the ztest output.
 *
 * Build only (no hardware needed)
 * ===============================
 * From the west workspace topdir (e.g. ~/zephyrproject):
 *
 *   west build -b tl5238x zephyr/tests/drivers/gpio/gpio_basic_api
 *
 *   west twister -p tl5238x \
 *     -T zephyr/tests/drivers/gpio/gpio_basic_api \
 *     --build-only \
 *     -- -DCONFIG_COMPILER_WARNINGS_AS_ERRORS=y
 *
 * Run on hardware via twister (loopback fixture)
 * ==============================================
 * The "gpio_loopback" fixture marks that the PD2<->PD3 jumper is present.
 * Twister also needs board flashing/runner configuration to actually run
 * (e.g. --device-testing --hardware-map <path>).
 *
 *   west twister -p tl5238x \
 *     -T zephyr/tests/drivers/gpio/gpio_basic_api \
 *     --fixture gpio_loopback \
 *     -- -DCONFIG_COMPILER_WARNINGS_AS_ERRORS=y
 *
 * Expected result / log characteristics
 * =====================================
 * The edge-triggered cases (rising, falling, both, to-active,
 * to-inactive) pass. On the serial console the edge test looks like:
 *
 *   START - test_gpio_callback_variants
 *   callback triggered: 1
 *   ...
 *   PASS - test_gpio_callback_variants
 *
 * "callback triggered: 1" is printed by the GPIO callback for each
 * detected edge (GPIO_INT_EDGE_BOTH prints a second "callback
 * triggered: 2"). A correct edge detection must NOT print
 * "edge not trigger callback correctly".
 *
 * Level-triggered cases print "Mode ... not supported" and are skipped
 * because the TL5X GPIO driver does not support level interrupts.
 */

/ {
	resources {
		compatible = "test-gpio-basic-api";
		out-gpios = <&gpiod 2 0>; /* PD2, LED White */
		in-gpios = <&gpiod 3 0>;  /* PD3, LED Green */
	};
};
