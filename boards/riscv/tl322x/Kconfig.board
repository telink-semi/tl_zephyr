## boards/riscv/tl322x/Kconfig.board
```kconfig
# Copyright (c) 2024 Telink Semiconductor
# SPDX-License-Identifier: Apache-2.0

config BOARD_TL3228X
	bool "Telink TL322X Platform"
	depends on SOC_RISCV_TELINK_TL322X

config BOARD_TL3228X_RETENTION
	bool "Telink TL322X Platform with retention"
	depends on SOC_RISCV_TELINK_TL322X
```

## boards/riscv/tl323x/Kconfig.board
```kconfig
# Copyright (c) 2024 Telink Semiconductor
# SPDX-License-Identifier: Apache-2.0

config BOARD_TL3238X
	bool "Telink TL323X Platform"
	depends on SOC_RISCV_TELINK_TL323X

config BOARD_TL3238X_RETENTION
	bool "Telink TL323X Platform with retention"
	depends on SOC_RISCV_TELINK_TL323X
```

## boards/riscv/tl721x/Kconfig.board
```kconfig
# Copyright (c) 2024 Telink Semiconductor
# SPDX-License-Identifier: Apache-2.0

config BOARD_TL7218X
	bool "Telink TL721X Platform"
	depends on SOC_RISCV_TELINK_TL721X

config BOARD_TL7218X_RETENTION
	bool "Telink TL721X Platform with retention"
	depends on SOC_RISCV_TELINK_TL721X

config BOARD_TL7218X_ML7G
	bool "Telink TL721X Platform with Module Board ML7G"
	depends on SOC_RISCV_TELINK_TL721X

config BOARD_TL7218X_ML7M
	bool "Telink TL721X Platform with Module Board ML7M"
	depends on SOC_RISCV_TELINK_TL721X
```

## boards/telink/tl321x/board.yml
```yaml
boards:
- name: tl3218x
  vendor: telink
  socs:
  - name: telink_tl3218x

- name: tl3218x_retention
  vendor: telink
  socs:
  - name: telink_tl3218x

- name: tl3218x_ml3m
  vendor: telink
  socs:
  - name: telink_tl3218x
```

## boards/telink/tl322x/Kconfig.tl3228x
```kconfig
# Copyright (c) 2025 Telink Semiconductor
# SPDX-License-Identifier: Apache-2.0

config BOARD_TL3228X
	help
		Telink TL322X Platform
```

## boards/telink/tl322x/Kconfig.tl3228x_retention
```kconfig
# Copyright (c) 2024 Telink Semiconductor
# SPDX-License-Identifier: Apache-2.0

config BOARD_TL3228X_RETENTION
	bool "Telink TL322X Platform with retention"
```

## boards/telink/tl322x/board.yml
```yaml
boards:
- name: tl3228x
  vendor: telink
  socs:
  - name: telink_tl3228x

- name: tl3228x_retention
  vendor: telink
  socs:
  - name: telink_tl3228x
```

## boards/telink/tl323x/Kconfig.tl3238x
```kconfig
# Copyright (c) 2025 Telink Semiconductor
# SPDX-License-Identifier: Apache-2.0

config BOARD_TL3238X
	bool "Telink TL323X Platform"
```

## boards/telink/tl323x/Kconfig.tl3238x_retention
```kconfig
# Copyright (c) 2025 Telink Semiconductor
# SPDX-License-Identifier: Apache-2.0

config BOARD_TL3238X_RETENTION
	bool "Telink TL323X Platform with retention"
```

## boards/telink/tl323x/board.yml
```yaml
boards:
- name: tl3238x
  vendor: telink
  socs:
  - name: telink_tl3238x

- name: tl3238x_retention
  vendor: telink
  socs:
  - name: telink_tl3238x
```

## boards/telink/tl521x/Kconfig.tl5218x_retention
```kconfig
# Copyright (c) 2026 Telink Semiconductor
# SPDX-License-Identifier: Apache-2.0

config BOARD_TL5218X_RETENTION
	help
		Telink TL521X Platform with retention
```

## boards/telink/tl521x/board.yml
```yaml
boards:
- name: tl5218x
  vendor: telink
  socs:
  - name: telink_tl5218x

- name: tl5218x_retention
  vendor: telink
  socs:
  - name: telink_tl5218x
```

## boards/telink/tl523x/Kconfig.tl5238x
```kconfig
# Copyright (c) 2025 Telink Semiconductor
# SPDX-License-Identifier: Apache-2.0

config BOARD_TL5238X
	bool "Telink TL523X Platform"
```

## boards/telink/tl523x/Kconfig.tl5238x_retention
```kconfig
# Copyright (c) 2025 Telink Semiconductor
# SPDX-License-Identifier: Apache-2.0

config BOARD_TL5238X_RETENTION
	bool "Telink TL523X Platform with retention"
```

## boards/telink/tl523x/board.yml
```yaml
boards:
- name: tl5238x
  vendor: telink
  socs:
  - name: telink_tl5238x

- name: tl5238x_retention
  vendor: telink
  socs:
  - name: telink_tl5238x
```

## boards/telink/tl721x/board.yml
```yaml
boards:
- name: tl7218x
  vendor: telink
  socs:
  - name: telink_tl7218x

- name: tl7218x_retention
  vendor: telink
  socs:
  - name: telink_tl7218x

- name: tl7218x_ml7g
  vendor: telink
  socs:
  - name: telink_tl7218x

- name: tl7218x_ml7m
  vendor: telink
  socs:
  - name: telink_tl7218x
```

## cmake/toolchain/andes-gcc/Kconfig
```kconfig
# Copyright (c) 2025 Telink Semiconductor
# SPDX-License-Identifier: Apache-2.0

config ANDES_GCC
	bool
	default y

config NEWLIB_LIBC_SUPPORTED
	def_bool y
	help
	  Andes supports newlib for C and C++ development.

config FPU
	def_bool y
	help
	  Andes supports HW FPU.

config FPU_SHARING
	def_bool y
	help
	  Andes supports HW FPU context switching.

config ANDES_CODENSE
	bool "Support CoDense instruction table"
	default y
	help
	  Andes supports CoDense instruction table.

config ANDES_HWDSP
	bool "Support Hardware DSP"
	default y
	select RISCV_SOC_CONTEXT_SAVE
	help
	  Andes supports DSP instructions.
```

## drivers/adc/Kconfig.tl521x
```kconfig
# Copyright (c) 2022-2026 Telink Semiconductor
# SPDX-License-Identifier: Apache-2.0

config ADC_TELINK_TL521X
	bool "Telink Semiconductor TL521x ADC driver"
	default y
	depends on DT_HAS_TELINK_TL521X_ADC_ENABLED
	select ADC_CONFIGURABLE_INPUTS
	help
	  Enables Telink TLx SD ADC driver.

if ADC_TELINK_TL521X

config ADC_TL521X_ACQUISITION_THREAD_STACK_SIZE
	int "Stack size for the ADC data acquisition thread"
	default 512
	help
	  Size of the stack used for the internal data acquisition
	  thread.

config ADC_TL521X_ACQUISITION_THREAD_PRIO
	int "Priority for the ADC data acquisition thread"
	default 0
	help
	  Priority level for the internal ADC data acquisition thread.

endif # ADC_TELINK_TL521X
```

## drivers/adc/Kconfig.tlx
```kconfig
# Copyright (c) 2024 Telink Semiconductor
# SPDX-License-Identifier: Apache-2.0

config ADC_TELINK_TLX
	bool "Telink Semiconductor TLx ADC driver"
	default y
	depends on DT_HAS_TELINK_TLX_ADC_ENABLED
	select ADC_CONFIGURABLE_INPUTS
	help
	  Enables Telink TLx ADC driver.

if ADC_TELINK_TLX

config ADC_TLX_ACQUISITION_THREAD_STACK_SIZE
	int "Stack size for the ADC data acquisition thread"
	default 512
	help
	  Size of the stack used for the internal data acquisition
	  thread.

config ADC_TLX_ACQUISITION_THREAD_PRIO
	int "Priority for the ADC data acquisition thread"
	default 0
	help
	  Priority level for the internal ADC data acquisition thread.

config ADC_TLX_ACQUISITION_QUEUE_SIZE
	int "Queue size for the ADC data acquisition"
	default 16
	help
	  Size of the queue used for the internal data acquisition.

choice
	prompt "Telink TLX ADC log level"
	default ADC_TELINK_TLX_LOG_LEVEL_INFO
	help
		This option selects log level for Telink TLX ADC driver.

config ADC_TELINK_TLX_LOG_LEVEL_CRIT
	bool "Critical"
config ADC_TELINK_TLX_LOG_LEVEL_WARN
	bool "Warning"
config ADC_TELINK_TLX_LOG_LEVEL_INFO
	bool "Informational"
config ADC_TELINK_TLX_LOG_LEVEL_DEBG
	bool "Debug"
endchoice

config ADC_TELINK_TLX_LOG_LEVEL
	int
	default 1 if ADC_TELINK_TLX_LOG_LEVEL_CRIT
	default 2 if ADC_TELINK_TLX_LOG_LEVEL_WARN
	default 3 if ADC_TELINK_TLX_LOG_LEVEL_INFO
	default 4 if ADC_TELINK_TLX_LOG_LEVEL_DEBG
	default 0

endif # ADC_TELINK_TLX
```

## drivers/audio/Kconfig.w91_audio
```kconfig
# Copyright 2025 Telink
# SPDX-License-Identifier: Apache-2.0

config AUDIO_TLSR9118
	bool "Telink audio codec support"
	# select I2C
	depends on DT_HAS_TELINK_W91_AUDIO_ENABLED
```

## drivers/entropy/Kconfig.tl521x
```kconfig
# Copyright (c) 2024-2026 Telink Semiconductor
# SPDX-License-Identifier: Apache-2.0

# Telink TL521X-series Entropy configuration options

config ENTROPY_TELINK_TL521X_TRNG
	bool "Telink TL521X-series Entropy driver"
	default y
	depends on DT_HAS_TELINK_TL521X_TRNG_ENABLED
	select ENTROPY_HAS_DRIVER
	help
	  Enable the TL521X-series Entropy driver.
```

## drivers/entropy/Kconfig.tl5x
```kconfig
# Copyright (c) 2024 Telink Semiconductor
# SPDX-License-Identifier: Apache-2.0

# Telink TLx-series GPIO configuration options

config ENTROPY_TELINK_TL5X_TRNG
	bool "Telink TL5x Entropy driver"
	default y
	depends on DT_HAS_TELINK_TL5X_TRNG_ENABLED
	select ENTROPY_HAS_DRIVER
	help
	  Enable the TL5x Entropy driver.
```

## drivers/ethernet/Kconfig.w91
```kconfig
# Copyright (c) 2025 Telink Semiconductor
# SPDX-License-Identifier: Apache-2.0

config ETH_W91
	bool "W91 SoC Ethernet support"
	default y if SOC_SERIES_RISCV_TELINK_W91
	help
		Enable Telink SoC Ethernet support.
```

## drivers/flash/Kconfig.tl521x
```kconfig
# Copyright (c) 2021-2026 Telink Semiconductor
# SPDX-License-Identifier: Apache-2.0

config SOC_FLASH_TELINK_TL521X
	bool "Telink Semiconductor TL521X flash driver"
	default y
	depends on DT_HAS_TELINK_TL521X_FLASH_CONTROLLER_ENABLED
	select FLASH_HAS_PAGE_LAYOUT
	select FLASH_HAS_DRIVER_ENABLED
	help
	  Enables Telink TL521X flash driver.
```

## drivers/gpio/Kconfig.tl521x
```kconfig
# Copyright (c) 2026 Telink Semiconductor
# SPDX-License-Identifier: Apache-2.0

# Telink TL521x-series GPIO configuration options

config GPIO_TELINK_TL521X
	bool "Telink TL521x-series GPIO driver"
	default y
	depends on DT_HAS_TELINK_TL521X_GPIO_ENABLED
	help
	  Enables the TL521x-series GPIO driver.
```
