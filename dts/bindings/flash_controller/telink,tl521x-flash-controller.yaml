## dts/bindings/flash_controller/telink,tl521x-flash-controller.yaml
```yaml
# Copyright (c) 2024-2026, Telink Semiconductor
# SPDX-License-Identifier: Apache-2.0

description: Telink TL521X Flash Controller

compatible: "telink,tl521x-flash-controller"

include: flash-controller.yaml

properties:
  reg:
    required: true
```

## dts/bindings/flash_controller/telink,tl523x-flash-controller.yaml
```yaml
# Copyright (c) 2026, Telink Semiconductor
# SPDX-License-Identifier: Apache-2.0

description: Telink TL523X Flash Controller

compatible: "telink,tl523x-flash-controller"

include: flash-controller.yaml

properties:
  reg:
    required: true
```

## dts/bindings/gpio/telink,tl5x-gpio.yaml
```yaml
# Copyright (c) 2024, Telink Semiconductor
# SPDX-License-Identifier: Apache-2.0

description: Telink TL5x GPIO node

compatible: "telink,tl5x-gpio"

include: [gpio-controller.yaml, base.yaml]

properties:
  reg:
    required: true

  "#gpio-cells":
    const: 2

gpio-cells:
  - pin
  - flags
```

## dts/bindings/i2c/telink,tl521x-i2c.yaml
```yaml
# Copyright (c) 2024-2026, Telink Semiconductor
# SPDX-License-Identifier: Apache-2.0

description: Telink TL521X I2C

include: [i2c-controller.yaml, pinctrl-device.yaml]

compatible: "telink,tl521x-i2c"

properties:
  reg:
    required: true

  pinctrl-0:
    required: true
```

## dts/bindings/i2s/telink,w91-i2s.yaml
```yaml
# SPDX-License-Identifier: Apache-2.0
description: Telink TLSR9118 I2S controller

compatible: "telink,w91-i2s"

include: base.yaml
```

## dts/bindings/ieee802154/telink,rcp-zb.yaml
```yaml
# Copyright (c) 2025, Telink Semiconductor
# SPDX-License-Identifier: Apache-2.0

description: Telink RCP IEEE802154 node

compatible: "telink,rcp-zb"

include: base.yaml

properties:
  serial:
    type: phandle
    required: true
    description: serial port for RCP connection
```

## dts/bindings/ieee802154/telink,tl521x-zb.yaml
```yaml
# Copyright (c) 2024-2026, Telink Semiconductor
# SPDX-License-Identifier: Apache-2.0

description: Telink TL521X IEEE802154 node

compatible: "telink,tl521x-zb"

include: base.yaml

properties:
  reg:
    required: true

  interrupts:
    required: true
```

## dts/bindings/input/telink,tlx-kscan-ana.yaml
```yaml
# Copyright (c) 2026, Telink Semiconductor
# SPDX-License-Identifier: Apache-2.0

description: Telink TLx kscan analog node

compatible: "telink,tlx-kscan-ana"

include: [base.yaml, pinctrl-device.yaml]

properties:
  reg:
    required: true

  interrupts:
    required: true

  pin-group:
    type: int
    required: true
    enum: [0, 1, 2, 3]
    description: GPIO pin group

  switch-enable-pin:
    type: phandle
    required: true
    description: enable pin for all analog switches

  switch-channel-pin:
    type: phandles
    required: true
    description: channels pins for the analog switches

  hall-power-pin:
    type: phandles
    required: true
    description: power pins the halls

  release-threshold:
    type: int
    required: true
    default: 768
    description: hall value release threshold

  press-threshold:
    type: int
    required: true
    default: 864
    description: hall value press threshold

  hall-init-time:
    type: int
    required: true
    default: 0x14
    description: t = (16*hall-init-time)*(1/ks_ana_clock_freq), default ks_ana_clock_freq = 8MHz
```

## dts/bindings/input/telink,tlx-kscan.yaml
```yaml
# Copyright (c) 2026, Telink Semiconductor
# SPDX-License-Identifier: Apache-2.0

description: Telink TLx kscan node

compatible: "telink,tlx-kscan"

include: [base.yaml, pinctrl-device.yaml]

properties:
  reg:
    required: true

  interrupts:
    required: true

  pinctrl-row:
    type: phandles
    required: true
    description: row pincontrol

  pinctrl-col:
    type: phandles
    required: true
    description: column pincontrol

  col-pull-type:
    type: int
    required: true
    enum: [0x10, 0x20, 0x13, 0x22]
    default: 0x22
    description: columns pull type

  debounce-period:
    type: int
    required: true
    enum: [0x2, 0x3, 0x4, 0x5, 0x6, 0x7]
    default: 0x2
    description: debounce period

  idle-period:
    type: int
    required: true
    enum: [
      1, 2, 3, 4, 5, 6, 7, 8, 9, 10,
      11, 12, 13, 14, 15, 16, 17, 18, 19, 20,
      21, 22, 23, 24, 25, 26, 27, 28, 29, 30,
      31, 32
    ]
    default: 1
    description: debounce cycles to enter the idle state

  scan-times:
    type: int
    required: true
    enum: [0, 1]
    default: 1
    description: scanning times
```

## dts/bindings/interrupt-controller/telink,plic.yaml
```yaml
# Copyright (c) 2018, SiFive Inc.
# Copyright (c) 2026, Telink Semiconductor
# SPDX-License-Identifier: Apache-2.0

description: Telink RISCV-V platform-local interrupt controller

compatible: "telink,plic"

include: riscv,plic0.yaml

properties:
  riscv,ndev:
    type: int
    description: Number of external interrupts supported
    required: true
```

## dts/bindings/nfc/st,st25dvxxkc.yaml
```yaml
#
# Copyright (c) 2025 Telink
#
# SPDX-License-Identifier: Apache-2.0
#

description: STM ST25DVXXKC IC

compatible: "st,st25dvxxkc"

include: i2c-device.yaml

properties:
  irq-gpios:
    type: phandle-array
    description: |
      The INT signal configuration is active-low.
```

## dts/bindings/rng/telink,tl521x-trng.yaml
```yaml
# Copyright (c) 2024-2026, Telink Semiconductor
# SPDX-License-Identifier: Apache-2.0

description: Telink TL521X-series RNG

compatible: "telink,tl521x-trng"

include: base.yaml

properties:
  reg:
    required: true
```

## dts/bindings/rng/telink,tl5x-trng.yaml
```yaml
# Copyright (c) 2025, Telink Semiconductor
# SPDX-License-Identifier: Apache-2.0

description: Telink TL5x-series RNG

compatible: "telink,tl5x-trng"

include: base.yaml

properties:
  reg:
    required: true
```

## dts/bindings/serial/telink,tl521x-uart.yaml
```yaml
# Copyright (c) 2024-2026, Telink Semiconductor
# SPDX-License-Identifier: Apache-2.0

description: Telink TL521X UART

compatible: "telink,tl521x-uart"

include: [uart-controller.yaml, pinctrl-device.yaml]

properties:
  reg:
    required: true

  interrupts:
    required: true

  pinctrl-0:
    required: true
```

## dts/bindings/serial/telink,tl5x-uart.yaml
```yaml
# Copyright (c) 2025, Telink Semiconductor
# SPDX-License-Identifier: Apache-2.0

description: Telink TL5x UART

compatible: "telink,tl5x-uart"

include: [uart-controller.yaml, pinctrl-device.yaml]

properties:
  reg:
    required: true

  interrupts:
    required: true

  pinctrl-0:
    required: true
```

## dts/bindings/telink,tlkdbg-uart.yaml
```yaml
# Copyright (c) 2026 Telink Semiconductor
# SPDX-License-Identifier: Apache-2.0

description: |
  Telink tlkdbg UART debug stream. The node only carries the pinmux for the
  TX pin; the UART itself is driven directly by the tlkdbg component.

compatible: "telink,tlkdbg-uart"

include: [pinctrl-device.yaml]
```

## dts/bindings/usb/telink,tl322x-usbd.yaml
```yaml
# Copyright (c) 2023 Telink Semiconductor
# SPDX-License-Identifier: Apache-2.0

description: |
    Telink Tl322x USB device controller

compatible: "telink,tl322x-usbd"

include: usb-ep.yaml

properties:
  reg:
    required: true

  interrupts:
    required: true
```

## dts/bindings/watchdog/telink,tl521x-watchdog.yaml
```yaml
# Copyright (c) 2024-2026, Telink Semiconductor
# SPDX-License-Identifier: Apache-2.0

description: Telink TL521X watchdog node

compatible: "telink,tl521x-watchdog"

include: base.yaml

properties:
  reg:
    required: true
```

## modules/Kconfig.telink
```kconfig
# Copyright (c) 2021-2024 Telink Semiconductor
# SPDX-License-Identifier: Apache-2.0

config HAS_TELINK_DRIVERS
	bool "Telink Drivers"
	help
	  This option enables Telink Drivers APIs.

config LZMA
	bool "LZMA data compression and decompression"
	help
	  This option enables lzma compression & decompression library
	  support.
```

## samples/boards/tlsr9x/sta_ap_ble_modes/Kconfig
```kconfig
# SPDX-License-Identifier: Apache-2.0

mainmenu "Wi-Fi AP/STA power test"

choice WIFI_TEST_MODE
	prompt "Wi-Fi power test mode"
	default WIFI_TEST_MODE_APSTA

config WIFI_TEST_MODE_STA
	bool "STA only"

config WIFI_TEST_MODE_AP
	bool "SoftAP only"

config WIFI_TEST_MODE_APSTA
	bool "SoftAP + STA"

config WIFI_TEST_MODE_APSTA_BLE
	bool "SoftAP + STA + BLE advertising"
	depends on BT && BT_BROADCASTER

endchoice

config WIFI_TEST_STA_DISCONNECTED_SECONDS
	int "STA disconnected baseline duration (seconds)"
	default 30
	range 1 3600
	depends on WIFI_TEST_MODE_STA
	help
	  Time spent in STA-only mode without a connection before the sample
	  starts the STA connection. This gives one run both disconnected and
	  connected idle measurement phases.

source "Kconfig.zephyr"
```

## samples/net/openthread/cli/boards/tl3218x.conf
```kconfig
# usb
CONFIG_USB_DEVICE_STACK=n
CONFIG_USB_DEVICE_INITIALIZE_AT_BOOT=n

# Telink relative thread features
CONFIG_NET_PKT_TXTIME=y
CONFIG_NET_PKT_TIMESTAMP=y
CONFIG_IEEE802154_TLX_MAC_FLASH=y

CONFIG_NET_BUF_TX_COUNT=12
CONFIG_NET_BUF_RX_COUNT=12
CONFIG_COMMON_LIBC_MALLOC_ARENA_SIZE=7168
```

## samples/net/openthread/cli/boards/tlsr9118bdk40d.conf
```kconfig
# Copyright (c) 2025 Telink Semiconductor
# SPDX-License-Identifier: Apache-2.0

# Telink relative thread features
CONFIG_NET_PKT_TXTIME=y
CONFIG_NET_PKT_TIMESTAMP=y

# nvs
CONFIG_NVS_LOOKUP_CACHE=y
CONFIG_NVS_LOOKUP_CACHE_SIZE=1024
```

## samples/net/openthread/cli/boards/tlsr9118bdk40d_v1.conf
```kconfig
# Copyright (c) 2025 Telink Semiconductor
# SPDX-License-Identifier: Apache-2.0

# Telink relative thread features
CONFIG_NET_PKT_TXTIME=y
CONFIG_NET_PKT_TIMESTAMP=y
CONFIG_OPENTHREAD_NUM_MESSAGE_BUFFERS=350

# nvs
CONFIG_NVS_LOOKUP_CACHE=y
CONFIG_NVS_LOOKUP_CACHE_SIZE=1024
```

## samples/net/openthread/cli/boards/tlsr9518adk80d.conf
```kconfig
# Copyright (c) 2024 Telink Semiconductor
# SPDX-License-Identifier: Apache-2.0

# Telink B91 TLSR9518ADK80D

CONFIG_NET_PKT_TXTIME=y
CONFIG_NET_PKT_TIMESTAMP=y
CONFIG_OPENTHREAD_NUM_MESSAGE_BUFFERS=128
CONFIG_IEEE802154_B9X_MAC_FLASH=y

CONFIG_LOG_MAX_LEVEL=4
CONFIG_LOG_BACKEND_SPINEL=n
CONFIG_LOG_BACKEND_RTT=n
CONFIG_LOG_BACKEND_UART=y
```
