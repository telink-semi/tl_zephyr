## drivers/i2c/Kconfig.tlx
```kconfig
# Copyright (c) 2021-2023 Telink Semiconductor
# SPDX-License-Identifier: Apache-2.0

config I2C_TELINK_TLX
	bool "Telink Semiconductor TLx-series I2C driver"
	default y
	depends on DT_HAS_TELINK_TLX_I2C_ENABLED
	help
	  Enables Telink TLx-series I2C driver.
```

## dts/bindings/timer/telink,timer-config.yaml
```yaml
# Copyright (c) 2024, Telink Semiconductor
# SPDX-License-Identifier: Apache-2.0

description: |
  This binding is used to configure the timer trigger mode,
  width mode, tick mode and input trigger capture tick value.

  Here is an example which defines timer modes and trigger tick value:

  / {
    timer_settings {
      compatible = "timer-config";
      timer-trigger-mode = <0x1>;
      timer-width-mode = <0x2>;
      timer-tick-mode = <0x3>;
      timer-gpio-trigger-tick = <0xA>;
    };
  }

compatible: "timer-config"

properties:
  timer-trigger-mode:
    type: int
    description: "Timer Trigger Mode"
    required: true

  timer-width-mode:
    type: int
    description: "Timer Width Mode"
    required: true

  timer-tick-mode:
    type: int
    description: "Timer Tick Mode"
    required: true

  timer-gpio-trigger-tick:
    type: int
    description: "Special trigger tick mode"
    required: true
```

## dts/bindings/timer/telink,timer-gpio.yaml
```yaml
# Copyright (c) 2024, Telink Semiconductor
# SPDX-License-Identifier: Apache-2.0

description: |
  This allows you to define a group of TIMER inputs and outputs. Each node in the
  group is controlled by a GPIO. Each NODE is defined in a child node of the
  timer-gpio node.

  Here is an example which defines two timer trigger outs in the node /tim_outs:

  / {
    tim_outs {
      compatible = "timer-gpio";

      tim_out_0 {
        gpios = <&gpioa 0 GPIO_ACTIVE_HIGH>;
        label = "TIM0 Trigger Out";
      };
      tim_out_1 {
        gpios = <&gpioa 1 GPIO_ACTIVE_HIGH>;
        label = "TIM1 Trigger Out";
      };
    };

  Above:

  - tim_out_0 is pin 0 on gpioa. The GPIO is active when the pin is high,
    and off when the pin is high.
  - tim_out_1 is pin 1 on gpioa. The GPIO is active when the pin is high,
    and off when it is low.

compatible: "timer-gpio"

child-binding:
  description: GPIO TIMER child node
  properties:
    gpios:
      type: phandle-array
      required: true
    label:
      type: string
      description: |
        Human readable string describing the TIM GPIO NODE. It can be used by an
        application to identify this NODE or to retrieve its number/index
        (i.e. child node number) on the parent device.
```

## samples/boards/tlsr9x/timer/sample.yaml
```yaml
sample:
  name: TIMER usage sample
tests:
  samples.boards.tlsr9x.timer:
    tags: timer tim
    depends_on: gpio
    harness: tim_outs
```

## soc/riscv/riscv-privilege/telink_tlx/Kconfig.soc
```kconfig
# Copyright (c) 2024 Telink Semiconductor
# SPDX-License-Identifier: Apache-2.0

choice
prompt "CPU Architecture of SoC"
depends on SOC_SERIES_RISCV_TELINK_TLX

config TLxCPU_RISCV32
	bool "RISCV32 CPU Architecture"
	select RISCV_ISA_RV32I
	select RISCV_ISA_EXT_M
	select RISCV_ISA_EXT_A
	select RISCV_ISA_EXT_C
	select RISCV_ISA_EXT_ZICSR
	select RISCV_ISA_EXT_ZIFENCEI

endchoice

config TELINK_TL321X_PMP
	bool "Support Hardware Memory Protection"
	depends on SOC_RISCV_TELINK_TL321X
	select RISCV_PMP
	help
		This option enables Telink TL321X PMP(memory protection) module.

config TELINK_TL721X_PMP
	bool "Support Hardware Memory Protection"
	depends on SOC_RISCV_TELINK_TL721X
	select RISCV_PMP
	help
		This option enables Telink TL721X PMP(memory protection) module.

config TELINK_TLX_HWDSP
	bool "Support Hardware DSP"
	select RISCV_SOC_CONTEXT_SAVE
	depends on SOC_SERIES_RISCV_TELINK_TLX
	default n

config TELINK_TLX_MBEDTLS_HW_ACCELERATION
	bool "Use Telink TLx platform mbedtls HW acceleration"
	depends on SOC_SERIES_RISCV_TELINK_TLX && MBEDTLS
	default y
	help
		This option enables Telink TLx hardware accelerated mbedtls version.

config TELINK_TLX_PFT_ARCH
	bool "Support performance throttling"
	default y
	select RISCV_SOC_CONTEXT_SAVE
	depends on SOC_SERIES_RISCV_TELINK_TLX

choice
prompt "Telink TLx SoCs implementation"
depends on SOC_SERIES_RISCV_TELINK_TLX

config SOC_RISCV_TELINK_TL721X
	bool "Telink TL721X SoC implementation"
	select ATOMIC_OPERATIONS_BUILTIN
	select CPU_HAS_FPU
	select INCLUDE_RESET_VECTOR

config SOC_RISCV_TELINK_TL321X
	bool "Telink TL321X SoC implementation"
	select ATOMIC_OPERATIONS_BUILTIN
	select INCLUDE_RESET_VECTOR

endchoice

config PMP_SLOTS
	default 16

config PM_DEVICE
	default y if PM

config SHELL_BACKENDS
	default n if PM

config TELINK_SOC_REBOOT_ON_FAULT
	bool "Reboot system when fault happened"
	depends on SOC_SERIES_RISCV_TELINK_TLX
	default n
	help
		This option enables Telink TLx chip reboot after fault.

config TELINK_SOC_REBOOT_ON_FAULT_DELAY
	int "Reboot system delay in mS"
	depends on SOC_SERIES_RISCV_TELINK_TLX && TELINK_SOC_REBOOT_ON_FAULT
	default 1000
	range 0 30000
	help
		This option sets Telink TLX chip reboot on fault delay in mS.

config TELINK_TLX_USB_SWI_DISABLE
	bool "Don't use USB SWI interface"
	depends on SOC_SERIES_RISCV_TELINK_TLX
	default n
	help
		This option disables USB SWI interface


config TELINK_TLX_2_WIRE_SPI_ENABLE
	bool "Use 2-wire SPI interface to FLASH"
	depends on SOC_SERIES_RISCV_TELINK_TLX
	default n
	help
		This option enables 2-wire SPI interface to FLASH

config TELINK_TLX_MALLOC_FAILED_HOOK
	bool "Stop SW execution when system heap allocation failed"
	depends on SOC_SERIES_RISCV_TELINK_TLX
	default y
	help
		This option stops SW execution when system heap allocation failed.

config TELINK_TLX_MATTER_RETENTION_LAYOUT
	bool "Support Matter retention layout"
	depends on SOC_SERIES_RISCV_TELINK_TLX_RETENTION
	default n
	help
		This option enables support Matter retention layout

config COMPRESS_LZMA
	bool "Support LZMA compression"
	default n
	select LZMA
	select BOOT_IMAGE_ACCESS_HOOKS
	depends on BOOTLOADER_MCUBOOT || MCUBOOT
	help
	  This option enables LZMA compression with MCUBoot

config COMPRESS_LZMA_DICTIONARY_SIZE
	int "Set LZMA compression dictionary size"
	default 32768
	depends on COMPRESS_LZMA
	help
	  This option sets LZMA compression dictionary size
```
