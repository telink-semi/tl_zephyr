## drivers/gpio/Kconfig.tl5x
```kconfig
# Copyright (c) 2024 Telink Semiconductor
# SPDX-License-Identifier: Apache-2.0

# Telink TL5x-series GPIO configuration options

config GPIO_TELINK_TL5X
	bool "Telink TL5x-series GPIO driver"
	default y
	depends on DT_HAS_TELINK_TL5X_GPIO_ENABLED
	help
	  Enables the TL5x-series GPIO driver.
```

## drivers/i2c/Kconfig.tl521x
```kconfig
# Copyright (c) 2024-2026 Telink Semiconductor
# SPDX-License-Identifier: Apache-2.0

config I2C_TELINK_TL521X
	bool "Telink Semiconductor TL521X-series I2C driver"
	default y
	depends on DT_HAS_TELINK_TL521X_I2C_ENABLED
	help
	  Enables Telink TL521X-series I2C driver.
```

## drivers/ieee802154/Kconfig.telink_rcp
```kconfig
# Copyright (c) 2025 Telink Semiconductor
# SPDX-License-Identifier: Apache-2.0

# Telink RCP RF configuration options

config IEEE802154_TELINK_RCP
	bool "Telink RCP RF driver"
	default y
	select SERIAL
	select UART_INTERRUPT_DRIVEN
	select TELINK_OT_RCP
	depends on DT_HAS_TELINK_RCP_ZB_ENABLED

if IEEE802154_TELINK_RCP

config IEEE802154_TELINK_RCP_DELAY_TRX_ACC
	int "Clock accuracy for delayed operations"
	default 20
	help
	  Accuracy of the clock used for scheduling radio delayed operations (delayed transmission
	  or delayed reception), in ppm.

config IEEE802154_TELINK_RCP_INIT_PRIO
	int "Telink RCP IEEE 802.15.4 initialization priority"
	default 80
	help
	  Set the initialization priority number. Do not mess with it unless
	  you know what you are doing.

endif # IEEE802154_TELINK_RCP
```

## drivers/ieee802154/Kconfig.tlx
```kconfig
# Copyright (c) 2024-2026 Telink Semiconductor
# SPDX-License-Identifier: Apache-2.0

# Telink TLX RF configuration options

menuconfig IEEE802154_TELINK_TLX
	bool "Telink TLX RF driver"
	default y
	depends on DT_HAS_TELINK_TLX_ZB_ENABLED

if IEEE802154_TELINK_TLX

config IEEE802154_TLX_INIT_PRIO
	int "Telink TLX IEEE 802.15.4 initialization priority"
	default 80
	help
	  Set the initialization priority number. Do not mess with it unless
	  you know what you are doing.

config IEEE802154_TLX_SET_TXRX_DELAY_US
	int "Tx/Rx modes switching delay time (us)"
	default 120
	help
	  Delay time needed for PLL stabilization during Tx/Rx modes switching.

config IEEE802154_TLX_CCA_RSSI_THRESHOLD
	int "CCA procedure RSSI threshold"
	default -70
	help
	  CCA procedure returns true if the current RSSI value is less than
	  this parameter.

choice IEEE802154_TLX_MAC_TYPE
	prompt "IEEE802154 MAC address type"
	default IEEE802154_TLX_MAC_RANDOM
config IEEE802154_TLX_MAC_RANDOM
	bool "Random MAC address"
config IEEE802154_TLX_MAC_FLASH
	bool "MAC address from flash"
config IEEE802154_TLX_MAC_STATIC
	bool "MAC address precompiled"
endchoice

config IEEE802154_TLX_DELAY_TRX_ACC
	int "Clock accuracy for delayed operations"
	default 40
	help
	  Accuracy of the clock used for scheduling radio delayed operations (delayed transmission
	  or delayed reception), in ppm.

config IEEE802154_TLX_BLE_COEXIST
	bool "Coexist with BLE (OT-BLE dual mode)"
	default n
	help
	  Enable this option to support OpenThread and BLE (Low Energy)
	  dual-mode coexistence on TLX SoCs. When enabled, the IEEE 802.15.4
	  radio driver will coordinate with the BLE controller to share the
	  RF resource.

config IEEE802154_TLX_OPTIMIZATION
	bool "Optimize 802.15.4 RF performance for TLX SoCs"
	default n
	help
	  Improve RF performance in IEEE 802.15.4 communication on TLX SoCs.

config IEEE802154_TLX_ACTIVE_STAGE_OPTIMIZATION
	bool "Active Stage Optimization"
	default y

if IEEE802154_TLX_MAC_STATIC

config IEEE802154_TLX_MAC4
	hex "MAC Address Byte 4"
	default 0
	range 0 0xff
	help
	  This is the byte 4 of the MAC address.

config IEEE802154_TLX_MAC5
	hex "MAC Address Byte 5"
	default 0
	range 0 0xff
	help
	  This is the byte 5 of the MAC address.

config IEEE802154_TLX_MAC6
	hex "MAC Address Byte 6"
	default 0
	range 0 0xff
	help
	  This is the byte 6 of the MAC address.

config IEEE802154_TLX_MAC7
	hex "MAC Address Byte 7"
	default 0
	range 0 0xff
	help
	  This is the byte 7 of the MAC address.

endif # IEEE802154_TLX_MAC_STATIC

endif # IEEE802154_TELINK_TLX
```

## drivers/ieee802154/Kconfig.w91
```kconfig
# Copyright (c) 2025 Telink Semiconductor
# SPDX-License-Identifier: Apache-2.0

# Telink W91 RF configuration options

config IEEE802154_TELINK_W91
	bool "Telink W91 RF driver"
	default y
	select SERIAL
	select UART_INTERRUPT_DRIVEN
	depends on DT_HAS_TELINK_W91_ZB_ENABLED

if IEEE802154_TELINK_W91

config IEEE802154_W91_DELAY_TRX_ACC
	int "Clock accuracy for delayed operations"
	default 20
	help
	  Accuracy of the clock used for scheduling radio delayed operations (delayed transmission
	  or delayed reception), in ppm.

endif # IEEE802154_TELINK_W91
```

## drivers/input/Kconfig
```kconfig
# Copyright 2023 Google LLC
# SPDX-License-Identifier: Apache-2.0

if INPUT

menu "Input drivers"

source "drivers/input/Kconfig.ft5336"
source "drivers/input/Kconfig.gpio_keys"
source "drivers/input/Kconfig.sdl"
source "drivers/input/Kconfig.tlx_kscan"

endmenu # Input Drivers

endif # INPUT
```

## drivers/input/Kconfig.tlx_kscan
```kconfig
# Copyright (c) 2026 Telink Semiconductor
# SPDX-License-Identifier: Apache-2.0

menuconfig INPUT_TELINK_TLX_KSCAN
	bool "Telink TLX KSCAN driver"
	default y
	depends on DT_HAS_TELINK_TLX_KSCAN_ENABLED

if INPUT_TELINK_TLX_KSCAN

endif # INPUT_TELINK_TLX_KSCAN
```

## drivers/input/Kconfig.tlx_kscan_ana
```kconfig
# Copyright (c) 2026 Telink Semiconductor
# SPDX-License-Identifier: Apache-2.0

config INPUT_TELINK_TLX_KSCAN_ANA
	bool "Telink TLX KSCAN Analog driver"
	default y
	depends on DT_HAS_TELINK_TLX_KSCAN_ANA_ENABLED

if INPUT_TELINK_TLX_KSCAN_ANA

config INPUT_TELINK_TLX_KSCAN_ANA_DMA_LLP_ENABLE
	bool "Telink TLX KSCAN Analog driver DMA LLP enable"
	default y

config INPUT_TELINK_TLX_KSCAN_ANA_SCAN_PERIOD_MS
	int "Telink TLX KSCAN Analog driver scan period, ms"
	default 10
	depends on INPUT_TELINK_TLX_KSCAN_ANA_DMA_LLP_ENABLE

endif # INPUT_TELINK_TLX_KSCAN_ANA
```

## drivers/interrupt_controller/Kconfig.telink
```kconfig
# Copyright (c) 2022 Carlo Caione <ccaione@baylibre.com>
# SPDX-License-Identifier: Apache-2.0

config PLIC_TELINK
	bool "Telink Interrupt Controller (PLIC)"
	default y
	depends on DT_HAS_TELINK_PLIC_ENABLED
	select MULTI_LEVEL_INTERRUPTS
	select 2ND_LEVEL_INTERRUPTS
	help
	  Platform Level Interrupt Controller provides support
	  for external interrupt lines defined by the RISC-V SoC.

if PLIC_TELINK

config PLIC_TELINK_SHELL
	bool "PLIC shell commands"
	depends on SHELL
	help
	  Enable additional shell commands useful for debugging.
	  Caution: This can use quite a bit of RAM (PLICs * IRQs * sizeof(uint16_t)).

if PLIC_TELINK_SHELL

config PLIC_TELINK_SHELL_IRQ_COUNT
	bool "IRQ count shell commands"
	default y
	help
	  Records the number of hits per interrupt line and provide shell commands to access them.
	  Caution: This can use quite a bit of RAM (PLICs * IRQs * sizeof(PLIC_IRQ_COUNT_TYPE)).

endif # PLIC_TELINK_SHELL

endif # PLIC_TELINK
```

## drivers/nfc/Kconfig
```kconfig
#
# Copyright (c) 2025 - 2026 Telink Semiconductor
#
# SPDX-License-Identifier: Apache-2.0
#

menuconfig NFC
	bool "NFC subsystem"
	help
		This option enables the NFC subsystem.

if NFC
	rsource "Kconfig.st25dvxxkc"
endif # NFC
```

## drivers/nfc/Kconfig.st25dvxxkc
```kconfig
#
# Copyright (c) 2023 - 2026 Telink Semiconductor
#
# SPDX-License-Identifier: Apache-2.0
#

config ST25DVXXKC
	bool "ST25DVXXKC NFC tag driver"
	default y
	depends on DT_HAS_ST_ST25DVXXKC_ENABLED
	select I2C
	help
		Enable I2C-based driver for ST25DVXXKC NFC tag.

if ST25DVXXKC

choice ST25DVXXK_LOG_LEVEL
	prompt "ST25DVXXK driver log level"
	help
		This option selects log level for ST25DVXXK driver.
config ST25DVXXKC_LOG_LEVEL_ERR
	bool "Error"
config ST25DVXXKC_LOG_LEVEL_WRN
	bool "Warning"
config ST25DVXXKC_LOG_LEVEL_INF
	bool "Information"
config ST25DVXXKC_LOG_LEVEL_DBG
	bool "Debug"
endchoice

config ST25DVXXKC_LOG_LEVEL
	int
	default 1 if ST25DVXXKC_LOG_LEVEL_ERR
	default 2 if ST25DVXXKC_LOG_LEVEL_WRN
	default 3 if ST25DVXXKC_LOG_LEVEL_INF
	default 4 if ST25DVXXKC_LOG_LEVEL_DBG
	default 0

config ST25DVXXKC_INIT_PRIORITY
	int "ST25DVXXKC NFC driver init priority"
	default 75

endif # ST25DVXXKC
```

## drivers/pinctrl/Kconfig.tl521x
```kconfig
# Copyright (c) 2024-2026 Telink Semiconductor
# SPDX-License-Identifier: Apache-2.0

config PINCTRL_TELINK_TL521X
	bool "Telink TL521X-series pin controller driver"
	default y
	depends on DT_HAS_TELINK_TL521X_PINCTRL_ENABLED
	help
	  Enables Telink TL521X-series pin controller driver
```

## drivers/pinctrl/Kconfig.tl5x
```kconfig
# Copyright (c) 2024 Telink Semiconductor
# SPDX-License-Identifier: Apache-2.0

config PINCTRL_TELINK_TL5X
	bool "Telink TL5x-series pin controller driver"
	default y
	depends on DT_HAS_TELINK_TL5X_PINCTRL_ENABLED
	help
	  Enables Telink TL5x-series pin controller driver
```

## drivers/pwm/Kconfig.b9x
```kconfig
# Copyright (c) 2021-2024 Telink Semiconductor
# SPDX-License-Identifier: Apache-2.0

config PWM_TELINK_B9X
	bool "Telink Semiconductor B9x PWM driver"
	default y
	depends on DT_HAS_TELINK_B9X_PWM_ENABLED
	help
	  Enables Telink B9x PWM driver.

config PWM_TELINK_B9X_MAX_CHANNELS
	int "Maximum number of PWM channels supported by B9x PWM"
	default 6
	depends on PWM_TELINK_B9X
	help
	  Defines maximum number of PWM channels supported by Telink B9x PWM hardware.
```

## drivers/pwm/Kconfig.tl521x
```kconfig
# Copyright (c) 2024-2026 Telink Semiconductor
# SPDX-License-Identifier: Apache-2.0

config PWM_TELINK_TL521X
	bool "Telink Semiconductor TL521X PWM driver"
	default y
	depends on DT_HAS_TELINK_TL521X_PWM_ENABLED
	help
	  Enables Telink TL521X PWM driver.

config PWM_TELINK_TL521X_MAX_CHANNELS
	int "Maximum number of PWM channels supported by TL521X PWM"
	default 6
	depends on PWM_TELINK_TL521X
	help
	  Defines maximum number of PWM channels supported by Telink TL521X PWM hardware.
```

## drivers/pwm/Kconfig.tlx
```kconfig
# Copyright (c) 2024 Telink Semiconductor
# SPDX-License-Identifier: Apache-2.0

config PWM_TELINK_TLX
	bool "Telink Semiconductor TLx PWM driver"
	default y
	depends on DT_HAS_TELINK_TLX_PWM_ENABLED
	help
	  Enables Telink TLx PWM driver.

config PWM_TELINK_TLX_MAX_CHANNELS
	int "Maximum number of PWM channels supported by TLx PWM"
	default 6
	depends on PWM_TELINK_TLX
	help
	  Defines maximum number of PWM channels supported by Telink TLx PWM hardware.
```

## drivers/serial/Kconfig.tl521x
```kconfig
# Copyright (c) 2026 Telink Semiconductor
# SPDX-License-Identifier: Apache-2.0

# Telink TL521X UART configuration options

config UART_TELINK_TL521X
	bool "Telink TL521X UART driver"
	default y
	depends on DT_HAS_TELINK_TL521X_UART_ENABLED
	select SERIAL_HAS_DRIVER
	select SERIAL_SUPPORT_INTERRUPT
	help
	  This option enables the TL521X serial driver.
```

## drivers/serial/Kconfig.tl5x
```kconfig
# Copyright (c) 2025 Telink Semiconductor
# SPDX-License-Identifier: Apache-2.0

# Telink TL5x UART configuration options

config UART_TELINK_TL5X
	bool "Telink TL5x UART driver"
	default y
	depends on DT_HAS_TELINK_TL5X_UART_ENABLED
	select SERIAL_HAS_DRIVER
	select SERIAL_SUPPORT_INTERRUPT
	help
	  This option enables the TL5x serial driver.
```

## drivers/spi/Kconfig.tl521x
```kconfig
# Copyright (c) 2026 Telink Semiconductor
# SPDX-License-Identifier: Apache-2.0

config SPI_TELINK_TL521X
	bool "Telink Semiconductor TL521X SPI driver"
	default y
	depends on DT_HAS_TELINK_TL521X_SPI_ENABLED
	help
	  Enables Telink TL521X SPI driver.
```

## drivers/watchdog/Kconfig.tl521x
```kconfig
# Copyright (c) 2024-2026 Telink Semiconductor
# SPDX-License-Identifier: Apache-2.0

# Telink TL521X WDT configuration options
config WDT_TELINK_TL521X
	bool "Telink TL521X series Watchdog (WDT) Driver"
	default y
	depends on DT_HAS_TELINK_TL521X_WATCHDOG_ENABLED
	help
	  Enable WDT driver for Telink TL521X-series MCUs.
```

## dts/bindings/audio/telink,w91-audio.yaml
```yaml
# Copyright (c) 2025 Telink
# SPDX-License-Identifier: Apache-2.0

description: Telink TLSR9118BDK40D audio codec abstract interface

compatible: "telink,w91-audio"

include: base.yaml

# include: i2s-device.yaml
```

## dts/bindings/bluetooth/telink,b9x-bt.yaml
```yaml
# Copyright (c) 2024, Telink Semiconductor
# SPDX-License-Identifier: Apache-2.0

description: Telink B9x Bluetooth HCI node

compatible: "telink,b9x-bt"

include: bt-hci.yaml

properties:
  bt-hci-name:
    default: "HCI Controller"
  bt-hci-bus:
    default: "virtual"
  bt-hci-quirks:
    default: ["no-auto-dle"]
```

## dts/bindings/bluetooth/telink,tlx-bt.yaml
```yaml
# Copyright (c) 2024, Telink Semiconductor
# SPDX-License-Identifier: Apache-2.0

description: Telink TLx Bluetooth HCI node

compatible: "telink,tlx-bt"

include: bt-hci.yaml

properties:
  bt-hci-name:
    default: "HCI Controller"
  bt-hci-bus:
    default: "virtual"
  bt-hci-quirks:
    default: ["no-auto-dle"]
```

## dts/bindings/cpu/telink,tl5x.yaml
```yaml
# Copyright (c) 2024 Telink Semiconductor
# SPDX-License-Identifier: Apache-2.0

description: Telink RISC-V CPU

compatible: "telink,tl5x"

include: riscv,cpus.yaml
```
